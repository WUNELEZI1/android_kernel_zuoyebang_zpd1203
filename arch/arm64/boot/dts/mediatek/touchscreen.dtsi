/*
 * Copyright (C) 2025 Novatek, Inc.
 *
 * $Revision$
 * $Date$
 *
 * This program is free software; you can redistribute it and/or modify
 * it under the terms of the GNU General Public License as published by
 * the Free Software Foundation; either version 2 of the License, or
 * (at your option) any later version.
 *
 * This program is distributed in the hope that it will be useful, but WITHOUT
 * ANY WARRANTY; without even the implied warranty of MERCHANTABILITY or
 * FITNESS FOR A PARTICULAR PURPOSE.  See the GNU General Public License for
 * more details.
 *
 */
&xiaomi_touch {
	status = "okay";
	compatible = "xiaomi-touch";
	touch,name = "xiaomi-touch";
};

&spi3 {
	status = "ok";

	/* Novatek device tree node */
	touch@0 {
		compatible = "novatek,NVT-ts-spi","focaltech,fts","omnivision,tcm-spi";
		reg = <0>; //Same as CS ID
		status = "ok";

		spi-max-frequency = <9600000>;	//4800000,9600000,15000000,19200000

		/*************** Omnivision TD4160 device tree ***************/
		omnivision,irq-gpio = <&pio 4 02>;
		omnivision,reset-gpio = <&pio 170 0>;
		omnivision,spi-mode = <3>;

                /*************** Focaltech FT8057M device tree ***************/
                //interrupt-parent = <&pio>;
        	//interrupts = <17 IRQ_TYPE_EDGE_FALLING 17 0>;
        	focaltech,reset-gpio = <&pio 170 0>;
        	focaltech,irq-gpio = <&pio 4 02>;
        	focaltech,max-touch-number = <10>;
        	focaltech,display-coords =  <0 0 719 1599>;

		/*************** Novatek NT36528 device tree ***************/
		novatek,reset-gpio = <&pio 170 0x00>;
		novatek,irq-gpio = <&pio 4 0x2001>;

		//novatek,pen-support;

		//novatek,spi-rd-fast-addr = <0x03F310>;

		/* MP */
		novatek,mp-support-dt;

		/* for Xiaomi P15 NT36528A Truly 6.9" panel module */
		novatek-mp-criteria-59A8@0 {
			#address-cells = <1>;
			#size-cells = <0>;
			compatible = "novatek-mp-criteria-59A8";

			/* MP Config */
			IC_X_CFG_SIZE = <18>;
			IC_Y_CFG_SIZE = <32>;
			IC_KEY_CFG_SIZE = <4>;
			X_Channel = <18>;
			Y_Channel = <32>;
			AIN_X = <0 1 2 3 4 5 6 7 8 9 10 11 12 13 14 15 16 17>;
			AIN_Y = <0 1 2 3 4 5 6 7 8 9 10 11 12 13 14 15 16 17 18 19 20 21 22 23 24 25 26 27 28 29 30 31>;
			AIN_KEY = <0 1 2 0xFF>;

			/* MP Criteria 20250515 v85 fw 4th spec*/
			PS_Config_Lmt_Short_Rawdata_P = <
				14008	14008	14008	14008	14008	14008	14008	14008	14008	14008	14008	14008	14008	14008	14008	14008	14008	14008
				14008	14008	14008	14008	14008	14008	14008	14008	14008	14008	14008	14008	14008	14008	14008	14008	14008	14008
				14008	14008	14008	14008	14008	14008	14008	14008	14008	14008	14008	14008	14008	14008	14008	14008	14008	14008
				14008	14008	14008	14008	14008	14008	14008	14008	14008	14008	14008	14008	14008	14008	14008	14008	14008	14008
				14008	14008	14008	14008	14008	14008	14008	14008	14008	14008	14008	14008	14008	14008	14008	14008	14008	14008
				14008	14008	14008	14008	14008	14008	14008	14008	14008	14008	14008	14008	14008	14008	14008	14008	14008	14008
				14008	14008	14008	14008	14008	14008	14008	14008	14008	14008	14008	14008	14008	14008	14008	14008	14008	14008
				14008	14008	14008	14008	14008	14008	14008	14008	14008	14008	14008	14008	14008	14008	14008	14008	14008	14008
				14008	14008	14008	14008	14008	14008	14008	14008	14008	14008	14008	14008	14008	14008	14008	14008	14008	14008
				14008	14008	14008	14008	14008	14008	14008	14008	14008	14008	14008	14008	14008	14008	14008	14008	14008	14008
				14008	14008	14008	14008	14008	14008	14008	14008	14008	14008	14008	14008	14008	14008	14008	14008	14008	14008
				14008	14008	14008	14008	14008	14008	14008	14008	14008	14008	14008	14008	14008	14008	14008	14008	14008	14008
				14008	14008	14008	14008	14008	14008	14008	14008	14008	14008	14008	14008	14008	14008	14008	14008	14008	14008
				14008	14008	14008	14008	14008	14008	14008	14008	14008	14008	14008	14008	14008	14008	14008	14008	14008	14008
				14008	14008	14008	14008	14008	14008	14008	14008	14008	14008	14008	14008	14008	14008	14008	14008	14008	14008
				14008	14008	14008	14008	14008	14008	14008	14008	14008	14008	14008	14008	14008	14008	14008	14008	14008	14008
				14008	14008	14008	14008	14008	14008	14008	14008	14008	14008	14008	14008	14008	14008	14008	14008	14008	14008
				14008	14008	14008	14008	14008	14008	14008	14008	14008	14008	14008	14008	14008	14008	14008	14008	14008	14008
				14008	14008	14008	14008	14008	14008	14008	14008	14008	14008	14008	14008	14008	14008	14008	14008	14008	14008
				14008	14008	14008	14008	14008	14008	14008	14008	14008	14008	14008	14008	14008	14008	14008	14008	14008	14008
				14008	14008	14008	14008	14008	14008	14008	14008	14008	14008	14008	14008	14008	14008	14008	14008	14008	14008
				14008	14008	14008	14008	14008	14008	14008	14008	14008	14008	14008	14008	14008	14008	14008	14008	14008	14008
				14008	14008	14008	14008	14008	14008	14008	14008	14008	14008	14008	14008	14008	14008	14008	14008	14008	14008
				14008	14008	14008	14008	14008	14008	14008	14008	14008	14008	14008	14008	14008	14008	14008	14008	14008	14008
				14008	14008	14008	14008	14008	14008	14008	14008	14008	14008	14008	14008	14008	14008	14008	14008	14008	14008
				14008	14008	14008	14008	14008	14008	14008	14008	14008	14008	14008	14008	14008	14008	14008	14008	14008	14008
				14008	14008	14008	14008	14008	14008	14008	14008	14008	14008	14008	14008	14008	14008	14008	14008	14008	14008
				14008	14008	14008	14008	14008	14008	14008	14008	14008	14008	14008	14008	14008	14008	14008	14008	14008	14008
				14008	14008	14008	14008	14008	14008	14008	14008	14008	14008	14008	14008	14008	14008	14008	14008	14008	14008
				14008	14008	14008	14008	14008	14008	14008	14008	14008	14008	14008	14008	14008	14008	14008	14008	14008	14008
				14008	14008	14008	14008	14008	14008	14008	14008	14008	14008	14008	14008	14008	14008	14008	14008	14008	14008
				14008	14008	14008	14008	14008	14008	14008	14008	14008	14008	14008	14008	14008	14008	14008	14008	14008	14008
				14008 14008 14008>;

			PS_Config_Lmt_Short_Rawdata_N = <
				10100	10100	10100	10100	10100	10100	10100	10100	10100	10100	10100	10100	10100	10100	10100	10100	10100	10100
				10100	10100	10100	10100	10100	10100	10100	10100	10100	10100	10100	10100	10100	10100	10100	10100	10100	10100
				10100	10100	10100	10100	10100	10100	10100	10100	10100	10100	10100	10100	10100	10100	10100	10100	10100	10100
				10100	10100	10100	10100	10100	10100	10100	10100	10100	10100	10100	10100	10100	10100	10100	10100	10100	10100
				10100	10100	10100	10100	10100	10100	10100	10100	10100	10100	10100	10100	10100	10100	10100	10100	10100	10100
				10100	10100	10100	10100	10100	10100	10100	10100	10100	10100	10100	10100	10100	10100	10100	10100	10100	10100
				10100	10100	10100	10100	10100	10100	10100	10100	10100	10100	10100	10100	10100	10100	10100	10100	10100	10100
				10100	10100	10100	10100	10100	10100	10100	10100	10100	10100	10100	10100	10100	10100	10100	10100	10100	10100
				10100	10100	10100	10100	10100	10100	10100	10100	10100	10100	10100	10100	10100	10100	10100	10100	10100	10100
				10100	10100	10100	10100	10100	10100	10100	10100	10100	10100	10100	10100	10100	10100	10100	10100	10100	10100
				10100	10100	10100	10100	10100	10100	10100	10100	10100	10100	10100	10100	10100	10100	10100	10100	10100	10100
				10100	10100	10100	10100	10100	10100	10100	10100	10100	10100	10100	10100	10100	10100	10100	10100	10100	10100
				10100	10100	10100	10100	10100	10100	10100	10100	10100	10100	10100	10100	10100	10100	10100	10100	10100	10100
				10100	10100	10100	10100	10100	10100	10100	10100	10100	10100	10100	10100	10100	10100	10100	10100	10100	10100
				10100	10100	10100	10100	10100	10100	10100	10100	10100	10100	10100	10100	10100	10100	10100	10100	10100	10100
				10100	10100	10100	10100	10100	10100	10100	10100	10100	10100	10100	10100	10100	10100	10100	10100	10100	10100
				10100	10100	10100	10100	10100	10100	10100	10100	10100	10100	10100	10100	10100	10100	10100	10100	10100	10100
				10100	10100	10100	10100	10100	10100	10100	10100	10100	10100	10100	10100	10100	10100	10100	10100	10100	10100
				10100	10100	10100	10100	10100	10100	10100	10100	10100	10100	10100	10100	10100	10100	10100	10100	10100	10100
				10100	10100	10100	10100	10100	10100	10100	10100	10100	10100	10100	10100	10100	10100	10100	10100	10100	10100
				10100	10100	10100	10100	10100	10100	10100	10100	10100	10100	10100	10100	10100	10100	10100	10100	10100	10100
				10100	10100	10100	10100	10100	10100	10100	10100	10100	10100	10100	10100	10100	10100	10100	10100	10100	10100
				10100	10100	10100	10100	10100	10100	10100	10100	10100	10100	10100	10100	10100	10100	10100	10100	10100	10100
				10100	10100	10100	10100	10100	10100	10100	10100	10100	10100	10100	10100	10100	10100	10100	10100	10100	10100
				10100	10100	10100	10100	10100	10100	10100	10100	10100	10100	10100	10100	10100	10100	10100	10100	10100	10100
				10100	10100	10100	10100	10100	10100	10100	10100	10100	10100	10100	10100	10100	10100	10100	10100	10100	10100
				10100	10100	10100	10100	10100	10100	10100	10100	10100	10100	10100	10100	10100	10100	10100	10100	10100	10100
				10100	10100	10100	10100	10100	10100	10100	10100	10100	10100	10100	10100	10100	10100	10100	10100	10100	10100
				10100	10100	10100	10100	10100	10100	10100	10100	10100	10100	10100	10100	10100	10100	10100	10100	10100	10100
				10100	10100	10100	10100	10100	10100	10100	10100	10100	10100	10100	10100	10100	10100	10100	10100	10100	10100
				10100	10100	10100	10100	10100	10100	10100	10100	10100	10100	10100	10100	10100	10100	10100	10100	10100	10100
				10100	10100	10100	10100	10100	10100	10100	10100	10100	10100	10100	10100	10100	10100	10100	10100	10100	10100
				10000 10000 10000>;

			PS_Config_Lmt_Open_Rawdata_P = <
				65535	2829	2842	2835	2815	2794	2789	2730	65535	65535	2716	2758	2764	2765	2762	2762	2747	65535
				2958	2975	2957	2944	2920	2883	2878	2863	2859	2751	2745	2751	2755	2773	2776	2772	2776	2813 
				2992	3004	2996	2990	2968	2941	2927	2912	2901	2806	2810	2818	2814	2818	2813	2796	2797	2838 
				2948	2979	2965	2955	2932	2906	2895	2884	2869	2806	2815	2820	2820	2822	2824	2815	2821	2863 
				3027	3070	3060	3055	3035	3011	2999	2990	2974	2887	2888	2897	2895	2899	2897	2880	2885	2918 
				3069	3125	3112	3104	3080	3058	3048	3032	3017	2902	2905	2911	2908	2909	2911	2899	2908	2939 
				2988	2997	2951	2941	2920	2892	2898	2881	2873	2974	2981	2989	2978	2983	2985	2974	3013	2895 
				3030	3031	2990	2979	2960	2936	2934	2923	2908	2997	3006	3004	2995	3000	3000	2992	3023	2925 
				3087	3084	3046	3034	3013	2990	2988	2979	2965	3023	3027	3035	3018	3028	3028	3017	3051	2962 
				3130	3123	3087	3070	3045	3027	3028	3014	3002	3031	3037	3042	3025	3031	3035	3025	3058	2983 
				3143	3132	3090	3080	3055	3031	3034	3025	3014	3181	3188	3185	3179	3186	3181	3170	3203	3137 
				3188	3171	3132	3121	3094	3073	3076	3058	3049	3161	3165	3171	3161	3165	3167	3158	3192	3139 
				3251	3234	3193	3186	3158	3136	3144	3125	3119	3144	3156	3153	3143	3150	3146	3133	3167	3125 
				3297	3277	3234	3228	3209	3185	3184	3171	3158	3217	3227	3227	3221	3228	3223	3212	3244	3210 
				3370	3345	3301	3298	3277	3254	3254	3241	3227	3317	3319	3328	3312	3325	3325	3310	3343	3331 
				3401	3374	3338	3326	3301	3279	3276	3266	3251	3259	3265	3266	3255	3262	3268	3256	3287	3283 
				3444	3412	3378	3373	3352	3332	3336	3322	3307	3371	3370	3377	3363	3368	3367	3350	3378	3388 
				3510	3476	3444	3431	3405	3385	3392	3373	3359	3368	3368	3374	3357	3363	3364	3354	3378	3391 
				3563	3529	3497	3490	3459	3437	3440	3419	3412	3441	3450	3448	3441	3444	3443	3433	3457	3475 
				3571	3535	3499	3497	3469	3448	3445	3433	3420	3452	3462	3459	3455	3457	3454	3444	3468	3494 
				3716	3676	3639	3637	3608	3581	3587	3569	3553	3480	3493	3497	3486	3490	3496	3483	3511	3543 
				3751	3714	3683	3675	3651	3625	3625	3611	3595	3615	3627	3632	3623	3629	3626	3615	3634	3664 
				3787	3742	3714	3707	3686	3665	3665	3653	3626	3660	3669	3675	3664	3667	3668	3650	3669	3702 
				3856	3814	3787	3767	3742	3720	3718	3703	3682	3669	3676	3682	3674	3679	3678	3665	3686	3714 
				3979	3930	3906	3900	3870	3846	3849	3832	3811	3784	3797	3802	3793	3800	3798	3784	3802	3836 
				3931	3891	3868	3856	3829	3809	3809	3790	3769	3837	3850	3857	3851	3860	3858	3849	3863	3895 
				4010	3970	3944	3937	3913	3892	3896	3878	3863	3868	3885	3888	3882	3881	3882	3871	3888	3924 
				4071	4025	4005	4001	3973	3952	3949	3928	3910	3899	3913	3923	3924	3927	3928	3916	3927	3966 
				3728	4091	4078	4071	4047	4021	4011	3990	3966	3951	3965	3973	3963	3970	3972	3952	3954	3619 
				3756	4151	4138	4123	4095	4070	4063	4042	4019	3984	3998	4005	4001	4010	4011	4003	4008	3647 
				3814	4318	4302	4285	4252	4227	4225	4210	4186	4088	4102	4106	4102	4113	4110	4102	4109	3651 
				3730	4012	4290	4281	4245	4220	4217	4200	4180	4101	4115	4119	4113	4123	4130	4117	3850	3609 
				5120 5120 5120>;

			PS_Config_Lmt_Open_Rawdata_N = <
				(-65535)	1213	1218	1215	1207	1198	1195	1170	(-65535)	(-65535)	1164	1182	1184	1185	1184	1184	1177	(-65535)
				1268	1275	1267	1262	1252	1235	1234	1227	1225	1179	1177	1179	1181	1189	1190	1188	1190	1205                
				1282	1288	1284	1282	1272	1261	1255	1248	1243	1202	1204	1208	1206	1208	1205	1198	1199	1216                
				1264	1277	1271	1267	1256	1246	1241	1236	1229	1202	1207	1208	1208	1210	1210	1207	1209	1227                
				1297	1316	1312	1309	1301	1291	1285	1282	1274	1237	1238	1241	1241	1243	1241	1234	1237	1250                
				1315	1339	1334	1330	1320	1310	1306	1300	1293	1244	1245	1247	1246	1247	1247	1243	1246	1259                
				1280	1285	1265	1261	1252	1240	1242	1235	1231	1274	1277	1281	1276	1279	1279	1274	1291	1241                
				1298	1299	1282	1277	1268	1258	1258	1253	1246	1285	1288	1288	1283	1286	1286	1282	1295	1253                
				1323	1322	1306	1300	1291	1282	1280	1277	1271	1295	1297	1301	1294	1298	1298	1293	1307	1270                
				1342	1339	1323	1316	1305	1297	1298	1292	1286	1299	1301	1304	1297	1299	1301	1297	1310	1279                
				1347	1342	1324	1320	1309	1299	1300	1297	1292	1363	1366	1365	1363	1366	1363	1358	1373	1345                
				1366	1359	1342	1337	1326	1317	1318	1310	1307	1355	1357	1359	1355	1357	1357	1354	1368	1345                
				1393	1386	1369	1366	1354	1344	1348	1339	1337	1348	1352	1351	1347	1350	1348	1343	1357	1339                
				1413	1405	1386	1384	1375	1365	1364	1359	1354	1379	1383	1383	1381	1384	1381	1376	1390	1376                
				1444	1433	1415	1414	1405	1394	1394	1389	1383	1421	1423	1426	1420	1425	1425	1418	1433	1427                
				1457	1446	1430	1426	1415	1405	1404	1400	1393	1397	1399	1400	1395	1398	1400	1396	1409	1407                
				1476	1462	1448	1445	1436	1428	1430	1424	1417	1445	1444	1447	1441	1444	1443	1436	1448	1452                
				1504	1490	1476	1471	1459	1451	1454	1445	1439	1444	1444	1446	1439	1441	1442	1438	1448	1453                
				1527	1513	1499	1496	1483	1473	1474	1465	1462	1475	1478	1478	1475	1476	1475	1471	1481	1489                
				1531	1515	1499	1499	1487	1478	1477	1471	1466	1480	1484	1483	1481	1481	1480	1476	1486	1498                
				1592	1576	1559	1559	1546	1535	1537	1529	1523	1492	1497	1499	1494	1496	1498	1493	1505	1519                
				1607	1592	1579	1575	1565	1553	1553	1547	1541	1549	1555	1556	1553	1555	1554	1549	1558	1570                
				1623	1604	1592	1589	1580	1571	1571	1565	1554	1568	1573	1575	1570	1571	1572	1564	1573	1586                
				1652	1634	1623	1615	1604	1594	1594	1587	1578	1573	1576	1578	1574	1577	1576	1571	1580	1592                
				1705	1684	1674	1672	1658	1648	1649	1642	1633	1622	1627	1630	1625	1628	1628	1622	1630	1644                
				1685	1667	1658	1652	1641	1633	1633	1624	1615	1645	1650	1653	1651	1654	1654	1649	1655	1669                
				1718	1702	1690	1687	1677	1668	1670	1662	1655	1658	1665	1666	1664	1663	1664	1659	1666	1682                
				1745	1725	1717	1715	1703	1694	1693	1684	1676	1671	1677	1681	1682	1683	1684	1678	1683	1700                
				1598	1753	1748	1745	1735	1723	1719	1710	1700	1693	1699	1703	1699	1702	1702	1694	1694	1551                
				1610	1779	1774	1767	1755	1744	1741	1732	1723	1708	1714	1717	1715	1718	1719	1715	1718	1563                
				1634	1850	1844	1837	1822	1811	1811	1804	1794	1752	1758	1760	1758	1763	1762	1758	1761	1565                
				1598	1720	1838	1835	1819	1808	1807	1800	1792	1757	1763	1765	1763	1767	1770	1765	1650	1547                
				(-511) (-511) (-511)>;

			PS_Config_Lmt_FW_Rawdata_P = <
				65535	1123	1116	1120	1127	1123	1114	1120	65535	65535	1117	1134	1099	1098	1098	1114	1121	65535
				1117	1110	1102	1120	1114	1116	1124	1138	1106	1124	1106	1107	1117	1123	1116	1126	1120	1134 
				1135	1110	1116	1107	1110	1103	1105	1106	1121	1126	1126	1113	1107	1110	1110	1127	1127	1117 
				1126	1119	1124	1121	1120	1123	1121	1120	1110	1113	1121	1126	1120	1120	1119	1127	1107	1117 
				1138	1096	1133	1095	1100	1099	1105	1102	1131	1141	1105	1109	1119	1117	1126	1110	1100	1128 
				1119	1119	1109	1127	1130	1134	1134	1130	1119	1110	1126	1127	1131	1127	1131	1112	1134	1105 
				1121	1124	1121	1120	1126	1131	1119	1124	1112	1112	1103	1098	1112	1105	1109	1117	1113	1114 
				1119	1124	1137	1112	1113	1126	1112	1124	1119	1113	1107	1116	1119	1119	1119	1120	1138	1110 
				1127	1123	1144	1114	1110	1107	1126	1130	1121	1114	1123	1121	1126	1123	1121	1105	1106	1140 
				1105	1119	1112	1126	1121	1121	1109	1110	1121	1112	1127	1135	1140	1137	1130	1124	1114	1120 
				1106	1102	1117	1130	1137	1140	1121	1106	1103	1114	1117	1112	1109	1109	1120	1120	1117	1119 
				1121	1128	1123	1116	1112	1114	1124	1140	1133	1124	1109	1105	1093	1085	1084	1093	1126	1128 
				1134	1148	1100	1099	1100	1103	1119	1128	1144	1117	1130	1121	1116	1120	1114	1123	1117	1134 
				1107	1124	1114	1112	1112	1113	1116	1120	1134	1109	1099	1109	1117	1109	1110	1106	1130	1102 
				1137	1114	1107	1098	1103	1103	1113	1121	1133	1105	1109	1113	1126	1120	1127	1121	1124	1116 
				1110	1105	1121	1127	1124	1121	1121	1116	1114	1109	1107	1105	1114	1112	1116	1110	1123	1130 
				1123	1128	1113	1119	1121	1123	1128	1137	1121	1121	1117	1117	1114	1113	1106	1106	1121	1109 
				1117	1119	1114	1120	1121	1124	1120	1119	1120	1114	1126	1130	1130	1126	1128	1120	1105	1117 
				1121	1123	1109	1099	1100	1102	1103	1106	1131	1105	1109	1124	1116	1116	1119	1120	1107	1124 
				1105	1113	1121	1124	1128	1126	1121	1121	1112	1138	1123	1116	1113	1114	1117	1117	1109	1106 
				1112	1116	1117	1128	1120	1126	1116	1114	1116	1116	1113	1120	1126	1123	1124	1124	1116	1133 
				1117	1121	1110	1121	1128	1127	1128	1130	1120	1119	1107	1112	1113	1112	1119	1135	1106	1092 
				1121	1116	1130	1123	1127	1131	1130	1116	1105	1138	1119	1123	1116	1121	1116	1105	1123	1112 
				1127	1128	1110	1098	1100	1096	1100	1098	1116	1110	1113	1109	1109	1109	1123	1131	1120	1106 
				1113	1114	1119	1124	1128	1123	1127	1123	1124	1096	1105	1099	1103	1099	1107	1113	1107	1113 
				1120	1121	1102	1099	1096	1098	1099	1099	1109	1120	1103	1106	1106	1112	1112	1112	1133	1140 
				1130	1126	1113	1105	1114	1116	1117	1124	1102	1124	1121	1114	1113	1119	1105	1096	1114	1127 
				1121	1119	1130	1128	1127	1123	1124	1130	1117	1145	1121	1120	1121	1120	1128	1099	1135	1134 
				1134	1095	1126	1110	1117	1117	1120	1121	1106	1124	1131	1127	1131	1131	1144	1117	1116	1109 
				1114	1116	1113	1113	1112	1107	1099	1105	1114	1131	1105	1099	1103	1105	1110	1100	1128	1107 
				1107	1110	1120	1124	1119	1116	1113	1109	1124	1127	1103	1100	1109	1112	1117	1113	1137	1127 
				1106	1119	1116	1106	1114	1109	1109	1119	1109	1102	1134	1123	1124	1120	1124	1128	1128	1093 
				3840 3840 3840>;

			PS_Config_Lmt_FW_Rawdata_N = <
				(-65535)	481	478	480	483	481	478	480	(-65535)	(-65535)	479	486	471	470	470	478	481	(-65535)
				479	476	472	480	478	478	482	488	474	482	474	475	479	481	478	482	480	486                       
				487	476	478	475	476	473	473	474	481	482	482	477	475	476	476	483	483	479                       
				482	479	482	481	480	481	481	480	476	477	481	482	480	480	479	483	475	479                       
				488	470	485	469	472	471	473	472	485	489	473	475	479	479	482	476	472	484                       
				479	479	475	483	484	486	486	484	479	476	482	483	485	483	485	476	486	473                       
				481	482	481	480	482	485	479	482	476	476	473	470	476	473	475	479	477	478                       
				479	482	487	476	477	482	476	482	479	477	475	478	479	479	479	480	488	476                       
				483	481	490	478	476	475	482	484	481	478	481	481	482	481	481	473	474	488                       
				473	479	476	482	481	481	475	476	481	476	483	487	488	487	484	482	478	480                       
				474	472	479	484	487	488	481	474	473	478	479	476	475	475	480	480	479	479                       
				481	484	481	478	476	478	482	488	485	482	475	473	469	465	464	469	482	484                       
				486	492	472	471	472	473	479	484	490	479	484	481	478	480	478	481	479	486                       
				475	482	478	476	476	477	478	480	486	475	471	475	479	475	476	474	484	472                       
				487	478	475	470	473	473	477	481	485	473	475	477	482	480	483	481	482	478                       
				476	473	481	483	482	481	481	478	478	475	475	473	478	476	478	476	481	484                       
				481	484	477	479	481	481	484	487	481	481	479	479	478	477	474	474	481	475                       
				479	479	478	480	481	482	480	479	480	478	482	484	484	482	484	480	473	479                       
				481	481	475	471	472	472	473	474	485	473	475	482	478	478	479	480	475	482                       
				473	477	481	482	484	482	481	481	476	488	481	478	477	478	479	479	475	474                       
				476	478	479	484	480	482	478	478	478	478	477	480	482	481	482	482	478	485                       
				479	481	476	481	484	483	484	484	480	479	475	476	477	476	479	487	474	468                       
				481	478	484	481	483	485	484	478	473	488	479	481	478	481	478	473	481	476                       
				483	484	476	470	472	470	472	470	478	476	477	475	475	475	481	485	480	474                       
				477	478	479	482	484	481	483	481	482	470	473	471	473	471	475	477	475	477                       
				480	481	472	471	470	470	471	471	475	480	473	474	474	476	476	476	485	488                       
				484	482	477	473	478	478	479	482	472	482	481	478	477	479	473	470	478	483                       
				481	479	484	484	483	481	482	484	479	491	481	480	481	480	484	471	487	486                       
				486	469	482	476	479	479	480	481	474	482	485	483	485	485	490	479	478	475                       
				478	478	477	477	476	475	471	473	478	485	473	471	473	473	476	472	484	475                       
				475	476	480	482	479	478	477	475	482	483	473	472	475	476	479	477	487	483                       
				474	479	478	474	478	475	475	479	475	472	486	481	482	480	482	484	484	469                       
				240 240 240>;

			PS_Config_Lmt_FW_CC_P = <
				65535	47	46	46	46	46	46	44	65535	65535	44	46	46	46	46	46	47	65535
				50	47	46	46	46	46	46	46	46	46	46	46	46	46	46	46	47	50         
				50	48	47	46	46	46	46	46	47	46	46	46	46	46	46	47	48	51         
				50	48	47	46	46	46	46	46	46	47	46	46	46	46	46	47	48	51         
				51	50	47	47	47	47	47	47	47	47	46	46	47	47	47	47	48	51         
				51	50	47	47	47	47	47	47	47	47	46	46	47	47	47	47	48	51         
				51	50	48	46	46	46	46	46	46	46	46	46	46	46	46	48	50	51         
				51	50	47	46	46	46	46	46	46	47	47	46	46	46	46	48	50	51         
				51	50	47	46	46	46	46	46	46	47	46	46	46	46	46	48	50	51         
				51	50	47	46	46	46	46	46	46	47	47	46	46	46	46	48	50	51         
				52	50	48	46	46	46	46	47	47	47	47	47	47	47	47	48	50	52         
				52	50	47	46	46	46	46	46	47	47	47	47	46	46	47	48	50	52         
				52	50	48	46	46	46	47	47	47	47	47	47	47	47	47	48	50	52         
				52	50	47	46	46	46	46	47	47	47	47	47	47	47	47	48	50	52         
				52	50	48	47	47	47	47	47	47	47	47	47	47	47	47	48	50	52         
				52	50	47	46	46	46	46	47	47	47	47	47	47	47	47	48	50	52         
				52	50	48	47	47	47	47	47	47	47	47	47	47	47	47	48	50	52         
				52	50	47	47	47	47	47	47	47	47	47	47	47	47	47	48	50	52         
				52	50	48	47	47	47	47	47	47	48	47	47	47	47	47	48	51	52         
				54	51	48	47	47	47	47	47	48	47	47	47	47	47	47	48	50	52         
				54	51	48	47	47	47	47	47	48	48	47	47	47	47	47	48	51	54         
				54	51	48	47	47	47	47	47	48	48	47	47	47	47	47	48	51	54         
				54	51	50	48	48	48	48	48	48	48	48	48	48	48	48	48	51	54         
				54	51	50	48	48	48	48	48	48	48	48	48	48	48	48	50	51	54         
				55	52	50	48	48	48	48	48	50	48	48	48	48	48	48	50	51	54         
				54	51	50	48	48	48	48	48	48	48	48	48	48	48	48	50	51	54         
				54	51	50	48	48	48	48	48	48	50	48	48	50	48	50	50	52	55         
				54	51	50	48	48	48	48	48	48	48	48	48	48	48	48	50	51	54         
				52	52	50	48	48	48	48	48	48	48	48	48	48	48	48	50	51	52         
				52	51	50	48	48	48	48	48	48	48	48	48	48	48	48	50	51	52         
				52	51	50	48	48	48	48	48	48	48	48	48	48	48	48	50	51	52         
				51	51	50	48	48	48	48	48	48	50	48	48	48	48	48	50	51	52         
				314 314 314>;

			PS_Config_Lmt_FW_CC_N = <
				(-65535)	21	20	20	20	20	20	20	(-65535)	(-65535)	20	20	20	20	20	20	21	(-65535)
				22	21	20	20	20	20	20	20	20	20	20	20	20	20	20	20	21	22                        
				22	22	21	20	20	20	20	20	21	20	20	20	20	20	20	21	22	23                        
				22	22	21	20	20	20	20	20	20	21	20	20	20	20	20	21	22	23                        
				23	22	21	21	21	21	21	21	21	21	20	20	21	21	21	21	22	23                        
				23	22	21	21	21	21	21	21	21	21	20	20	21	21	21	21	22	23                        
				23	22	22	20	20	20	20	20	20	20	20	20	20	20	20	22	22	23                        
				23	22	21	20	20	20	20	20	20	21	21	20	20	20	20	22	22	23                        
				23	22	21	20	20	20	20	20	20	21	20	20	20	20	20	22	22	23                        
				23	22	21	20	20	20	20	20	20	21	21	20	20	20	20	22	22	23                        
				24	22	22	20	20	20	20	21	21	21	21	21	21	21	21	22	22	24                        
				24	22	21	20	20	20	20	20	21	21	21	21	20	20	21	22	22	24                        
				24	22	22	20	20	20	21	21	21	21	21	21	21	21	21	22	22	24                        
				24	22	21	20	20	20	20	21	21	21	21	21	21	21	21	22	22	24                        
				24	22	22	21	21	21	21	21	21	21	21	21	21	21	21	22	22	24                        
				24	22	21	20	20	20	20	21	21	21	21	21	21	21	21	22	22	24                        
				24	22	22	21	21	21	21	21	21	21	21	21	21	21	21	22	22	24                        
				24	22	21	21	21	21	21	21	21	21	21	21	21	21	21	22	22	24                        
				24	22	22	21	21	21	21	21	21	22	21	21	21	21	21	22	23	24                        
				24	23	22	21	21	21	21	21	22	21	21	21	21	21	21	22	22	24                        
				24	23	22	21	21	21	21	21	22	22	21	21	21	21	21	22	23	24                        
				24	23	22	21	21	21	21	21	22	22	21	21	21	21	21	22	23	24                        
				24	23	22	22	22	22	22	22	22	22	22	22	22	22	22	22	23	24                        
				24	23	22	22	22	22	22	22	22	22	22	22	22	22	22	22	23	24                        
				25	24	22	22	22	22	22	22	22	22	22	22	22	22	22	22	23	24                        
				24	23	22	22	22	22	22	22	22	22	22	22	22	22	22	22	23	24                        
				24	23	22	22	22	22	22	22	22	22	22	22	22	22	22	22	24	25                        
				24	23	22	22	22	22	22	22	22	22	22	22	22	22	22	22	23	24                        
				24	24	22	22	22	22	22	22	22	22	22	22	22	22	22	22	23	24                        
				24	23	22	22	22	22	22	22	22	22	22	22	22	22	22	22	23	24                        
				24	23	22	22	22	22	22	22	22	22	22	22	22	22	22	22	23	24                        
				23	23	22	22	22	22	22	22	22	22	22	22	22	22	22	22	23	24                        
				0 0 0>;

			PS_Config_Lmt_FW_Diff_P = <
				65535	50	50	50	50	50	50	50	65535	65535	50	50	50	50	50	50	50	65535
				50	50	50	50	50	50	50	50	50	50	50	50	50	50	50	50	50	50         
				50	50	50	50	50	50	50	50	50	50	50	50	50	50	50	50	50	50         
				50	50	50	50	50	50	50	50	50	50	50	50	50	50	50	50	50	50         
				50	50	50	50	50	50	50	50	50	50	50	50	50	50	50	50	50	50         
				50	50	50	50	50	50	50	50	50	50	50	50	50	50	50	50	50	50         
				50	50	50	50	50	50	50	50	50	50	50	50	50	50	50	50	50	50         
				50	50	50	50	50	50	50	50	50	50	50	50	50	50	50	50	50	50         
				50	50	50	50	50	50	50	50	50	50	50	50	50	50	50	50	50	50         
				50	50	50	50	50	50	50	50	50	50	50	50	50	50	50	50	50	50         
				50	50	50	50	50	50	50	50	50	50	50	50	50	50	50	50	50	50         
				50	50	50	50	50	50	50	50	50	50	50	50	50	50	50	50	50	50         
				50	50	50	50	50	50	50	50	50	50	50	50	50	50	50	50	50	50         
				50	50	50	50	50	50	50	50	50	50	50	50	50	50	50	50	50	50         
				50	50	50	50	50	50	50	50	50	50	50	50	50	50	50	50	50	50         
				50	50	50	50	50	50	50	50	50	50	50	50	50	50	50	50	50	50         
				50	50	50	50	50	50	50	50	50	50	50	50	50	50	50	50	50	50         
				50	50	50	50	50	50	50	50	50	50	50	50	50	50	50	50	50	50         
				50	50	50	50	50	50	50	50	50	50	50	50	50	50	50	50	50	50         
				50	50	50	50	50	50	50	50	50	50	50	50	50	50	50	50	50	50         
				50	50	50	50	50	50	50	50	50	50	50	50	50	50	50	50	50	50         
				50	50	50	50	50	50	50	50	50	50	50	50	50	50	50	50	50	50         
				50	50	50	50	50	50	50	50	50	50	50	50	50	50	50	50	50	50         
				50	50	50	50	50	50	50	50	50	50	50	50	50	50	50	50	50	50         
				50	50	50	50	50	50	50	50	50	50	50	50	50	50	50	50	50	50         
				50	50	50	50	50	50	50	50	50	50	50	50	50	50	50	50	50	50         
				50	50	50	50	50	50	50	50	50	50	50	50	50	50	50	50	50	50         
				50	50	50	50	50	50	50	50	50	50	50	50	50	50	50	50	50	50         
				50	50	50	50	50	50	50	50	50	50	50	50	50	50	50	50	50	50         
				50	50	50	50	50	50	50	50	50	50	50	50	50	50	50	50	50	50         
				50	50	50	50	50	50	50	50	50	50	50	50	50	50	50	50	50	50         
				50	50	50	50	50	50	50	50	50	50	50	50	50	50	50	50	50	50         
				75 75 75>;

			PS_Config_Lmt_FW_Diff_N = <
				(-65535)	(-50)	(-50)	(-50)	(-50)	(-50)	(-50)	(-50)	(-65535)	(-65535)	(-50)	(-50)	(-50)	(-50)	(-50)	(-50)	(-50)	(-65535)
				(-50)	(-50)	(-50)	(-50)	(-50)	(-50)	(-50)	(-50)	(-50)	(-50)	(-50)	(-50)	(-50)	(-50)	(-50)	(-50)	(-50)	(-50)               
				(-50)	(-50)	(-50)	(-50)	(-50)	(-50)	(-50)	(-50)	(-50)	(-50)	(-50)	(-50)	(-50)	(-50)	(-50)	(-50)	(-50)	(-50)               
				(-50)	(-50)	(-50)	(-50)	(-50)	(-50)	(-50)	(-50)	(-50)	(-50)	(-50)	(-50)	(-50)	(-50)	(-50)	(-50)	(-50)	(-50)               
				(-50)	(-50)	(-50)	(-50)	(-50)	(-50)	(-50)	(-50)	(-50)	(-50)	(-50)	(-50)	(-50)	(-50)	(-50)	(-50)	(-50)	(-50)               
				(-50)	(-50)	(-50)	(-50)	(-50)	(-50)	(-50)	(-50)	(-50)	(-50)	(-50)	(-50)	(-50)	(-50)	(-50)	(-50)	(-50)	(-50)               
				(-50)	(-50)	(-50)	(-50)	(-50)	(-50)	(-50)	(-50)	(-50)	(-50)	(-50)	(-50)	(-50)	(-50)	(-50)	(-50)	(-50)	(-50)               
				(-50)	(-50)	(-50)	(-50)	(-50)	(-50)	(-50)	(-50)	(-50)	(-50)	(-50)	(-50)	(-50)	(-50)	(-50)	(-50)	(-50)	(-50)               
				(-50)	(-50)	(-50)	(-50)	(-50)	(-50)	(-50)	(-50)	(-50)	(-50)	(-50)	(-50)	(-50)	(-50)	(-50)	(-50)	(-50)	(-50)               
				(-50)	(-50)	(-50)	(-50)	(-50)	(-50)	(-50)	(-50)	(-50)	(-50)	(-50)	(-50)	(-50)	(-50)	(-50)	(-50)	(-50)	(-50)               
				(-50)	(-50)	(-50)	(-50)	(-50)	(-50)	(-50)	(-50)	(-50)	(-50)	(-50)	(-50)	(-50)	(-50)	(-50)	(-50)	(-50)	(-50)               
				(-50)	(-50)	(-50)	(-50)	(-50)	(-50)	(-50)	(-50)	(-50)	(-50)	(-50)	(-50)	(-50)	(-50)	(-50)	(-50)	(-50)	(-50)               
				(-50)	(-50)	(-50)	(-50)	(-50)	(-50)	(-50)	(-50)	(-50)	(-50)	(-50)	(-50)	(-50)	(-50)	(-50)	(-50)	(-50)	(-50)               
				(-50)	(-50)	(-50)	(-50)	(-50)	(-50)	(-50)	(-50)	(-50)	(-50)	(-50)	(-50)	(-50)	(-50)	(-50)	(-50)	(-50)	(-50)               
				(-50)	(-50)	(-50)	(-50)	(-50)	(-50)	(-50)	(-50)	(-50)	(-50)	(-50)	(-50)	(-50)	(-50)	(-50)	(-50)	(-50)	(-50)               
				(-50)	(-50)	(-50)	(-50)	(-50)	(-50)	(-50)	(-50)	(-50)	(-50)	(-50)	(-50)	(-50)	(-50)	(-50)	(-50)	(-50)	(-50)               
				(-50)	(-50)	(-50)	(-50)	(-50)	(-50)	(-50)	(-50)	(-50)	(-50)	(-50)	(-50)	(-50)	(-50)	(-50)	(-50)	(-50)	(-50)               
				(-50)	(-50)	(-50)	(-50)	(-50)	(-50)	(-50)	(-50)	(-50)	(-50)	(-50)	(-50)	(-50)	(-50)	(-50)	(-50)	(-50)	(-50)               
				(-50)	(-50)	(-50)	(-50)	(-50)	(-50)	(-50)	(-50)	(-50)	(-50)	(-50)	(-50)	(-50)	(-50)	(-50)	(-50)	(-50)	(-50)               
				(-50)	(-50)	(-50)	(-50)	(-50)	(-50)	(-50)	(-50)	(-50)	(-50)	(-50)	(-50)	(-50)	(-50)	(-50)	(-50)	(-50)	(-50)               
				(-50)	(-50)	(-50)	(-50)	(-50)	(-50)	(-50)	(-50)	(-50)	(-50)	(-50)	(-50)	(-50)	(-50)	(-50)	(-50)	(-50)	(-50)               
				(-50)	(-50)	(-50)	(-50)	(-50)	(-50)	(-50)	(-50)	(-50)	(-50)	(-50)	(-50)	(-50)	(-50)	(-50)	(-50)	(-50)	(-50)               
				(-50)	(-50)	(-50)	(-50)	(-50)	(-50)	(-50)	(-50)	(-50)	(-50)	(-50)	(-50)	(-50)	(-50)	(-50)	(-50)	(-50)	(-50)               
				(-50)	(-50)	(-50)	(-50)	(-50)	(-50)	(-50)	(-50)	(-50)	(-50)	(-50)	(-50)	(-50)	(-50)	(-50)	(-50)	(-50)	(-50)               
				(-50)	(-50)	(-50)	(-50)	(-50)	(-50)	(-50)	(-50)	(-50)	(-50)	(-50)	(-50)	(-50)	(-50)	(-50)	(-50)	(-50)	(-50)               
				(-50)	(-50)	(-50)	(-50)	(-50)	(-50)	(-50)	(-50)	(-50)	(-50)	(-50)	(-50)	(-50)	(-50)	(-50)	(-50)	(-50)	(-50)               
				(-50)	(-50)	(-50)	(-50)	(-50)	(-50)	(-50)	(-50)	(-50)	(-50)	(-50)	(-50)	(-50)	(-50)	(-50)	(-50)	(-50)	(-50)               
				(-50)	(-50)	(-50)	(-50)	(-50)	(-50)	(-50)	(-50)	(-50)	(-50)	(-50)	(-50)	(-50)	(-50)	(-50)	(-50)	(-50)	(-50)               
				(-50)	(-50)	(-50)	(-50)	(-50)	(-50)	(-50)	(-50)	(-50)	(-50)	(-50)	(-50)	(-50)	(-50)	(-50)	(-50)	(-50)	(-50)               
				(-50)	(-50)	(-50)	(-50)	(-50)	(-50)	(-50)	(-50)	(-50)	(-50)	(-50)	(-50)	(-50)	(-50)	(-50)	(-50)	(-50)	(-50)               
				(-50)	(-50)	(-50)	(-50)	(-50)	(-50)	(-50)	(-50)	(-50)	(-50)	(-50)	(-50)	(-50)	(-50)	(-50)	(-50)	(-50)	(-50)               
				(-50)	(-50)	(-50)	(-50)	(-50)	(-50)	(-50)	(-50)	(-50)	(-50)	(-50)	(-50)	(-50)	(-50)	(-50)	(-50)	(-50)	(-50)               
				(-75) (-75) (-75)>;

			PS_Config_Diff_Test_Frame = <50>;
		};
	};
};
