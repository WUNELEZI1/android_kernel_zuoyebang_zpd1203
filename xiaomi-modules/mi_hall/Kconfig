## xiaomi-modules/mi_hall/Kconfig
```kconfig
config XIAOMI_HALL_KEY
	tristate "support kernel hall_key"
	default n
	help
	  Say yes here to support kernel hall_key
```

## xiaomi-modules/mi_led/deco_led/Kconfig
```kconfig
config LEDS_AW21036
	tristate "LED Support for AW21036"
	depends on LEDS_CLASS && I2C
	help
	  this option enables support for the AW21036RGB LED connected
	  through I2C. Say Y to enable support for the AW21036LED
	  light automatically.
```

## xiaomi-modules/mi_net/Kconfig
```kconfig
source "../xiaomi-modules/mi_net/minet/Kconfig"
source "../xiaomi-modules/mi_net/miwillp/Kconfig"
source "../xiaomi-modules/mi_net/miicmpfilter/Kconfig"
source "../xiaomi-modules/mi_net/ftun/Kconfig"
```

## xiaomi-modules/mi_net/miicmpfilter/Kconfig
```kconfig
menuconfig NET_MIICMPFILTER
    tristate "MiIcmpFilter driver support"
    default m
    help
      xiaomi network engine.

      To compile this driver as a module, choose M here: the module
      will be called miicmpfilter.

      if unsure, say N.
```

## xiaomi-modules/mi_net/minet/Kconfig
```kconfig
# SPDX-License-Identifier: GPL-2.0-only
#
# MINET feature configuration
#
config NET_MINET
	tristate "MiNet driver support"
	default m
	help
	  xiaomi network engine.

	  To compile this driver as a module, choose M here: the module
	  will be called minet.

	  if unsure, say N.
```

## xiaomi-modules/mi_net/miwillp/Kconfig
```kconfig
# SPDX-License-Identifier: GPL-2.0-only
#
# MIWILL feature configuration
#
config NET_MIWILL
	tristate "MiWiLL driver support"
	default m
	help
	  This allows one to create virtual interfaces that teams together
	  multiple 802.11 wireless interfaces.

	  MiWiLL devices can be added using the "ip" command from the
	  iproute2 package:

	  "ip link add link [ address MAC ] [ NAME ] type miwill"

	  To compile this driver as a module, choose M here: the module
	  will be called miwill.

	  if unsure, say N.

config NET_MIWILL_MODE_RANDOM
	tristate "Random mode support"
	depends on NET_MIWILL
	default m
	help
	  Basic mode where port used for transmitting packets is selected
	  randomly.

	  To compile this team mode as a module, choose M here: the module
	  will be called miwill_mode_random.


config NET_MIWILL_MODE_REDUDANCY
	tristate "Redudancy mode support"
	depends on NET_MIWILL
	default m
	help
	  The redudancy mode where packets are transmitted always by all suitable ports.

	  Different with the team-type devices, all added ports keep own device
	  address, and the new miwill device has its own device address.

	  To compile this miwill mode as a module, choose M here: the module
	  will be called miwill_mode_redudancy.
```

## xiaomi-modules/touch_driver/o80/Kconfig
```kconfig
#
# Goodix touchscreen driver configuration
#
config TOUCHSCREEN_XIAOMI_TOUCHFEATURE_O80
	tristate "Xiaomi Touch Feature"
	depends on INPUT_TOUCHSCREEN
	help
	  Say Y here if you enable xiaomi touch feature.

	  If unsure, say N.

	  To compile this driver as a module, choose M here:
config TOUCHSCREEN_GOODIX_BRL_9916R
	tristate "Goodix berlin touchscreen"
```

## xiaomi-modules/vendor_stability/Kconfig
```kconfig
# SPDX-License-Identifier: GPL-2.0-only
source "../xiaomi-modules/vendor_stability/bootinfo/Kconfig"
source "../xiaomi-modules/vendor_stability/dump_display/Kconfig"
source "../xiaomi-modules/vendor_stability/mtd/Kconfig"
source "../xiaomi-modules/vendor_stability/boottime/Kconfig"
source "../xiaomi-modules/vendor_stability/hardwareinfo/Kconfig"
```

## xiaomi-modules/vendor_stability/bootinfo/Kconfig
```kconfig
# SPDX-License-Identifier: GPL-2.0

config	XM_BOOTINFO
	tristate "bootinfo config"
	help
	  Say Y or M here to enable bootinfo
```

## xiaomi-modules/vendor_stability/hardwareinfo/Kconfig
```kconfig
# SPDX-License-Identifier: GPL-2.0-only
#
# Mi Hardwareinfo
#

config HARDWARE_INFO
	tristate "Hardware Info support"
	default n
	help
	This adds support for Hardware Info.
```

## xring-configs/O1/O1_eng_defconfig
```kconfig
CONFIG_XRING_DEBUG=y # nocheck: debug version
CONFIG_USB_CONFIGFS_F_LB_SS=y
CONFIG_USB_F_SS_LB=y
CONFIG_USB_EHSET_TEST_FIXTURE=y
CONFIG_USB_TEST=y
CONFIG_XRING_TRACE_HOOK=m
CONFIG_XRING_CLK_TRACE=y # nocheck: debug version
CONFIG_XRING_DVFS_TRACE=y # nocheck: debug version
# CONFIG_MODULE_SIG_PROTECT is not set
CONFIG_CORESIGHT=y
CONFIG_CORESIGHT_SOURCE_ETM4X=y
CONFIG_ETM4X_IMPDEF_FEATURE=y
CONFIG_CORESIGHT_TRBE=y
CONFIG_CORESIGHT_LINKS_AND_SINKS=y
CONFIG_XRING_QI_DEBUG=y
CONFIG_XRING_QS_DEBUG=y
CONFIG_XRING_QIS_TEST=m # nocheck: debug version
CONFIG_UBSAN_BOOL=y # nocheck: debug version
CONFIG_UBSAN_ENUM=y # nocheck: debug version
CONFIG_UBSAN_SHIFT=y # nocheck: debug version
CONFIG_UBSAN_UNREACHABLE=y
CONFIG_LOCKDEP=y # nocheck: debug version
CONFIG_LOCKDEP_BITS=15 # nocheck: debug version
CONFIG_LOCKDEP_CHAINS_BITS=16 # nocheck: debug version
CONFIG_LOCKDEP_STACK_TRACE_BITS=19 # nocheck: debug version
CONFIG_LOCKDEP_STACK_TRACE_HASH_BITS=14 # nocheck: debug version
CONFIG_LOCKDEP_CIRCULAR_QUEUE_BITS=22 # nocheck: debug version
CONFIG_DEBUG_RT_MUTEXES=y
CONFIG_DEBUG_SPINLOCK=y
CONFIG_DEBUG_MUTEXES=y
CONFIG_DEBUG_RWSEMS=y
CONFIG_DPM_WATCHDOG=y
CONFIG_DPM_WATCHDOG_TIMEOUT=12
CONFIG_PM_ADVANCED_DEBUG=y
CONFIG_PM_DEBUG=y
CONFIG_PM_SLEEP_DEBUG=y
CONFIG_PM_TEST_SUSPEND=y
CONFIG_CORESIGHT_DUMMY=m
CONFIG_XR_CORESIGHT_LINK_AND_SINK_TMC=m # nocheck: debug version
CONFIG_XRING_HEAP_NOC_DFX=y
```

## xring-configs/xiaomi/build/Kconfig
```kconfig
menu "Xiaomi Modules"
source "../xiaomi-modules/consumerir/Kconfig"
source "../xiaomi-modules/touch_driver/o2s/Kconfig"
source "../xiaomi-modules/touch_driver/o80/Kconfig"
source "../xiaomi-modules/mi_led/deco_led/Kconfig"
source "../xiaomi-modules/fingerprint/mi_fp/Kconfig"
source "../xiaomi-modules/vendor_stability/Kconfig"
source "../xiaomi-modules/keyboard_driver/jinghu/Kconfig"
source "../xiaomi-modules/mi_net/Kconfig"
source "../xiaomi-modules/mi_hall/Kconfig"
source "../xiaomi-modules/mi_dynamic_readahead/Kconfig"
endmenu
```

## xring-configs/xring_fuzz_defconfig
```kconfig
CONFIG_KCOV=y
CONFIG_KCOV_INSTRUMENT_ALL=y
CONFIG_KCOV_ENABLE_COMPARISONS=y
CONFIG_DEBUG_FS=y
CONFIG_CONFIGFS_FS=y
CONFIG_SECURITYFS=y
CONFIG_DEBUG_INFO=y
CONFIG_DEBUG_KMEMLEAK=y
CONFIG_KALLSYMS=y
CONFIG_KALLSYMS_ALL=y
CONFIG_STACKTRACE=y
CONFIG_PAGE_OWNER=y
CONFIG_XRING_WDT_DISABLE=y
```

## xring-configs/xring_kasan_defconfig
```kconfig
CONFIG_XRING_DEBUG=y
CONFIG_KASAN=y
CONFIG_KASAN_SW_TAGS=y # nocheck: kasan version
# CONFIG_KASAN_HW_TAGS is not set
CONIFG_FRAME_WARN=0
# CONFIG_XRING_CLK_HOOK is not set
# CONFIG_MODULE_SIG_PROTECT is not set
CONFIG_KASAN_INLINE=y
CONFIG_KASAN_PANIC_ON_WARN=y # nocheck: kasan version
CONFIG_PANIC_ON_WARN_DEFAULT_ENABLE=y # nocheck: kasan version
CONIFG_FRAME_WARN=0
CONFIG_XRING_SCHED_WALT_DEBUG=m
# CONFIG_RANDOMIZE_BASE is not set
CONFIG_CORESIGHT=y
CONFIG_CORESIGHT_DUMMY=m
CONFIG_CORESIGHT_LINKS_AND_SINKS=y
CONFIG_XR_CORESIGHT_LINK_AND_SINK_TMC=m
CONFIG_STACKTRACE=y # nocheck: kasan version
CONFIG_PAGE_OWNER =y # nocheck: kasan version
```

## xring-modules/Kconfig.ext
```kconfig
# SPDX-License-Identifier: GPL-2.0
menu "Xring Modules"

# source "../xring-modules/demo/Kconfig"
source "../xring-modules/drivers/Kconfig"
source "../xring-modules/secure/securelib/Kconfig"
source "../xring-modules/helloworld/Kconfig"
source "../xring-modules/helloworld_dep/Kconfig"
source "../xring-modules/xring_ramdisk/Kconfig"
source "../xring-modules/xring-hook/Kconfig"
source "../xring-modules/mca/Kconfig"
source "../xring-modules/switch/Kconfig"
source "../xring-modules/kdump_demo/Kconfig"
source "../xring-modules/softlockup_demo/Kconfig"
source "../xring-modules/hungtask_demo/Kconfig"
source "../xring-modules/hwid/Kconfig"
endmenu

source "../xiaomi-modules/Kconfig"
```

## xring-modules/drivers/Kconfig
```kconfig
menu "Xring Device Drivers"

source "../xring-modules/drivers/clk/Kconfig"
source "../xring-modules/drivers/uwb_sr200/Kconfig"
source "../xring-modules/drivers/dfx/Kconfig"
source "../xring-modules/drivers/wdt/Kconfig"
source "../xring-modules/drivers/ddr/Kconfig"
source "../xring-modules/drivers/l3/Kconfig"
source "../xring-modules/drivers/dse/Kconfig"
source "../xring-modules/drivers/tee/Kconfig"
source "../xring-modules/drivers/tee/mitee/tui/Kconfig"
source "../xring-modules/drivers/display/Kconfig"
source "../xring-modules/drivers/mem_adapter/Kconfig"
source "../xring-modules/drivers/heaps/Kconfig"
source "../xring-modules/drivers/smmu/Kconfig"
source "../xring-modules/drivers/atf_mdr/Kconfig"
source "../xring-modules/drivers/kmod_protect/Kconfig"
source "../xring-modules/drivers/cpu_sched/Kconfig"
source "../xring-modules/drivers/cpufreq/Kconfig"
source "../xring-modules/drivers/cpuidle/Kconfig"
source "../xring-modules/drivers/atf_shmem/Kconfig"
source "../xring-modules/drivers/noc/Kconfig"
source "../xring-modules/drivers/ufs/Kconfig"
source "../xring-modules/drivers/rpmb/Kconfig"
source "../xring-modules/drivers/nv/Kconfig"
source "../xring-modules/drivers/zram/Kconfig"
source "../xring-modules/drivers/lpctrl/Kconfig"
source "../xring-modules/drivers/pinctrl/Kconfig"
source "../xring-modules/drivers/uart/Kconfig"
source "../xring-modules/drivers/hwspinlock/Kconfig"
source "../xring-modules/drivers/pwm/Kconfig"
source "../xring-modules/drivers/ipc/Kconfig"
source "../xring-modules/drivers/xr_coul/Kconfig"
source "../xring-modules/drivers/mmc/Kconfig"
source "../xring-modules/drivers/npufreq/Kconfig"
source "../xring-modules/drivers/video/Kconfig"
source "../xring-modules/drivers/camera/Kconfig"
source "../xring-modules/drivers/spi/Kconfig"
source "../xring-modules/drivers/gpufreq/Kconfig"
source "../xring-modules/drivers/mihw/Kconfig"
source "../xring-modules/drivers/gpu/arm/Kconfig"
source "../xring-modules/drivers/fts_spi/Kconfig"
source "../xring-modules/drivers/virtio_rpmsg/Kconfig"
source "../xring-modules/drivers/hpc/Kconfig"
source "../xring-modules/drivers/i2c/Kconfig"
source "../xring-modules/drivers/timestamp/Kconfig"
source "../xring-modules/drivers/sensorhub/Kconfig"
source "../xring-modules/drivers/regulator/Kconfig"
source "../xring-modules/drivers/vote_mng/Kconfig"
source "../xring-modules/drivers/perf/Kconfig"
source "../xring-modules/drivers/timer/Kconfig"
source "../xring-modules/drivers/dma/Kconfig"
source "../xring-modules/drivers/audio/Kconfig"
source "../xring-modules/drivers/i2c_dev/Kconfig"
source "../xring-modules/drivers/pci/Kconfig"
source "../xring-modules/drivers/pcie_test/Kconfig"
source "../xring-modules/drivers/uart_switch/Kconfig"
source "../xring-modules/drivers/dsu_pmu/Kconfig"
source "../xring-modules/drivers/xr_kdump/Kconfig"
source "../xring-modules/drivers/usb/Kconfig"
source "../xring-modules/drivers/xsp/Kconfig"
source "../xring-modules/drivers/rtc/Kconfig"
source "../xring-modules/drivers/ocm/Kconfig"
source "../xring-modules/drivers/reset/Kconfig"
source "../xring-modules/drivers/test/sample_kernel_ca/Kconfig"
source "../xring-modules/drivers/fbe/Kconfig"
source "../xring-modules/drivers/doze/Kconfig"
source "../xring-modules/drivers/ab_slot/Kconfig"
source "../xring-modules/drivers/spmi/Kconfig"
source "../xring-modules/drivers/pmic/Kconfig"
source "../xring-modules/drivers/pm_comm/Kconfig"
source "../xring-modules/drivers/thermal/Kconfig"
source "../xring-modules/drivers/efuse/Kconfig"
source "../xring-modules/drivers/dfx_bootup/Kconfig"
source "../xring-modules/drivers/modem/Kconfig"
source "../xring-modules/drivers/xrse/Kconfig"
source "../xring-modules/drivers/coresight/Kconfig"
source "../xring-modules/drivers/lowmemorykiller/Kconfig"
source "../xring-modules/drivers/typec/Kconfig"
source "../xring-modules/drivers/xr_arm_ffa/Kconfig"
source "../xring-modules/drivers/nt36532/Kconfig"
source "../xring-modules/drivers/nfc-mi/Kconfig"
source "../xring-modules/drivers/nfc_ese/Kconfig"
source "../xring-modules/drivers/ntag/Kconfig"
source "../xring-modules/drivers/dmd/Kconfig"
source "../xring-modules/drivers/xrcrypto/Kconfig"
source "../xring-modules/drivers/i3c/Kconfig"
source "../xring-modules/drivers/rf_chip/Kconfig"
source "../xring-modules/drivers/xr_minidump/Kconfig"
source "../xring-modules/drivers/tango/Kconfig"
source "../xring-modules/drivers/bootup_track/Kconfig"
source "../xring-modules/drivers/migt/Kconfig"

config XRING_DEBUG
    bool "Xring kernel debug enabled"
    default n
    help
      This option used to enable the xring kernel debug.

config XR_VERSION_ATE
    bool "Xring kernel enable ATE"
    help
      This option used to enable Auto Test Equipment.

config XR_VERSION_SLT
    bool "Xring kernel enable SLT"
    help
      This option used to enable System Level Test.

config FACTORY_BUILD
    bool "distiguish factory version from dev version"
    default n
    help
      This macro will be defined when build factory version. It is used to
      distinguish factory and dev codes in kernel.

endmenu
```

## xring-modules/drivers/ab_slot/Kconfig
```kconfig
config XRING_AB_SLOT_BOOTABLE_CTRL
	tristate "Support for XRing AB Slot Bootable Control"
	help
	  Say M here to build support for the AB Slot Bootable Control
	  driver. This driver provides sysfs node to set bootable flag
	  of ab slot in system control register.
```

## xring-modules/drivers/atf_mdr/Kconfig
```kconfig
config XRING_ATF_MDR
	tristate "support kernel handle for atf mdr notification"
	default n
	help
	  Say yes here to support kernel handle for atf mdr notification
```

## xring-modules/drivers/atf_shmem/Kconfig
```kconfig
config XRING_ATF_SHMEM
	tristate "support kernel atf_shmem"
	default n
	help
	  Say yes here to support kernel atf_shmem
```

## xring-modules/drivers/audio/Kconfig
```kconfig
source "../xring-modules/drivers/audio/asoc/codec/xring_codec/madera/Kconfig"
source "../xring-modules/drivers/audio/asoc/codec/xring_pa/Kconfig"
source "../xring-modules/drivers/audio/asoc/codec/xring_codec/Kconfig"



config XRING_AUDIO
	tristate "X-Ring audio driver"
	default m
	help
	  This feature supports build xring audio drivers.
	  If M, enable called.
	  Enable audio driver.
```

## xring-modules/drivers/audio/asoc/codec/xring_codec/Kconfig
```kconfig
config XRING_CODEC
	tristate "X-Ring audio extern codec driver"
	help
		This feature supports build xring audio drivers.
		if M, enable called.
		enable audio driver.
		default m.
```

## xring-modules/drivers/audio/asoc/codec/xring_codec/madera/Kconfig
```kconfig
config XRING_CODEC_MFD_CS47L92
	tristate "X-Ring audio codec mfd cs47l92"
	help
		This feature supports build xring audio drivers.
		if M, enable called.
		enable audio driver.
		default m.
```

## xring-modules/drivers/audio/asoc/codec/xring_pa/Kconfig
```kconfig
config XRING_SMARTPA
	tristate "X-Ring audio extern smartpa driver"
	help
		This feature supports build xring audio drivers.
		if M, enable called.
		enable audio driver.
		default m.
```
