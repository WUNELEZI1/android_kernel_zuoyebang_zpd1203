## xring-modules/drivers/l3/Kconfig
```kconfig
menu "L3 Drivers"

source "../xring-modules/drivers/l3/l3_devfreq/Kconfig"
source "../xring-modules/drivers/l3/l3_lp_ctrl/Kconfig"

endmenu
```

## xring-modules/drivers/l3/l3_devfreq/Kconfig
```kconfig
config XRING_L3_DEVFREQ
	tristate "Support for XRing L3 Devfreq Driver"
	default n
	depends on PM_DEVFREQ
	select PM_OPP
	help
	  This enables the XRing L3 devfreq driver.
```

## xring-modules/drivers/l3/l3_lp_ctrl/Kconfig
```kconfig
config XRING_L3_LP_CTRL
	tristate "Support for XRing L3 Low Power Control Driver"
	default n
	help
	  This enables the XRing L3 Low Power Control Driver.
```

## xring-modules/drivers/lpctrl/Kconfig
```kconfig
config XRING_LP_MDR
	tristate "Support for lpctrl dfx"
	depends on XRING_MDR && XRING_DMD
	default n
	help
	  This module is design for lpctrl DFX
```

## xring-modules/drivers/mem_adapter/Kconfig
```kconfig
menu "XRING MEM ADAPTER"

config XRING_MEM_ADAPTER
        tristate "XRING MEM ADAPTER"
        help
          Choose this option to enable xring mem adapter.
          When enable this option, you will use APIs from os adapter to get
          meminfo, do memory reclaim, kill process, do cache operation, do TLB
          operations and so on ...

config XRING_HEAP_DMA_MAP
        tristate "XRING HEAP DMA MAP"
        help
          Choose this option to enable xring heap dma map.
          When enable this option, dma_map_sgtable will be replaced by
          xring_iommu_map_dmabuf to get iova when a device has an iommu behind,
          and then can AFBC feature can be enabled by this operation.

config XRING_MM_ABORD
        bool "XRING MEM ABORD"
        help
          Choose this option to enable mem abord opt.
          When enable this option, you will use APIs from os adapter to abord
          madvise or compactd in certain scenarios to improve performance,
          and so on ...

config XRING_KSHRINK_SLABD
        bool "XRING KSHRINK SLABD"
        help
          Choose this option to enable kshrink slabd.
          When the system enters a low memory scenario or the user actively
          triggers recycling, shrink_slab will be executed asynchronously to
          reduce the synchronization waiting time.

config XRING_MM_EVENT
        bool "XRING MEMORY EVENT"
        default n
        depends on MIEV
        help
          Big data tracking in memory, connected to miev

endmenu
```

## xring-modules/drivers/mihw/Kconfig
```kconfig
config MILLET_CGROUP
	tristate "frozen framework cgroup"
	help
	  Mi frozen function

config MILLET_SIG
	tristate "frozen framework signal"
	help
	  Mi frozen function

config MILLET_BINDER
	tristate "frozen framework binder"
	help
	  Mi frozen function

config MILLET_PKG
	tristate "frozen framework pkg"
	help
	  Mi frozen function

config MILLET_BINDER_GKI
	tristate "frozen framework binder gki"
	help
	  Mi frozen function

config MILLET_CORE
	tristate "frozen framework core"
	help
	  Mi frozen function

config MILLET_HS
	tristate "frozen framework hs"
	help
	  Mi frozen function
```

## xring-modules/drivers/mmc/Kconfig
```kconfig
# SPDX-License-Identifier: GPL-2.0-only
#
# MMC subsystem configuration
#

config XRING_MMC_DRIVER
    tristate "XRING MMC host driver"
    depends on MMC_SDHCI_PLTFM
    depends on OF
    depends on COMMON_CLK
    help
      This select Xring MMC Controller Driver Support  based on Synopsys DesignWare
      Cores Mobile Storage Controller
      Xring should say Y or M here.

config XRING_MMC_PLATFORM_O1
	bool "XRING MMC platform config"
    depends on XRING_MMC_DRIVER
	help
	  This is an option to select different configuration on platfrom O1
```

## xring-modules/drivers/modem/Kconfig
```kconfig
config XRING_MODEM
	tristate "XRING modem driver"
        default m
	help
		Whether to compile modem driver

menu "DEVLINK"

config MTK_DEVLINK
 bool "mtk devlink support"
 help
   Used to control the whole devlink on the platform

config MTK_DEVLINK_LOGDUMP_SUPPORT
 bool "mtk devlink logdump support"
 help
   Used to control devlink logdump feature on the platform
endmenu # devlink
```

## xring-modules/drivers/nfc_ese/Kconfig
```kconfig
config NXP_NFC_ESE
	tristate "NXP NCI based NFC SPI Slave Driver for SNxxx"
	depends on SPI
	help
	  This enables the NFC ESE driver for SNxxx based devices.
	  If unsure, say Y.
```

## xring-modules/drivers/noc/Kconfig
```kconfig
config XRING_NOC
        tristate "Support for XRing noc"

config XRING_NOC_DMA_EXCEPTION
	bool "Enable XRing noc dma exception"
	depends on XRING_NOC
```

## xring-modules/drivers/npufreq/Kconfig
```kconfig
# NPUfreq Configuration

config XRING_NPUFREQ_DRV
	tristate "XRing NPU Freq Driver"
	depends on OF
	help
	  NPU Frequency scaling allows you to change the clock speed of
	  NPU on the fly. This is a nice method to save power, because
	  the lower the NPU clock speed, the less power the NPU consumes.
	  Note this driver need cowork with governor.

config XRING_NPUFRQ_QOS
	tristate "XRing NPU Freq QOS"
	depends on PM
	help
	  Governor used to change NPU Frequency, support user layer and kernel
	  layer request the qos and arbitrate a final Frequency. It also support
	  upper and lower limit vote.
```

## xring-modules/drivers/nt36532/Kconfig
```kconfig
config XRING_NT36532
	tristate "support kernel NT36532 touch"
	help
	  Say M here if you have a Novatek NT36xxx no flash touchscreen connected
	  to your system by SPI bus.

	  If unsure, say N.
```

## xring-modules/drivers/nv/Kconfig
```kconfig
config XRING_NV
	tristate "XRING NV Driver"

	help
	  This support NV driver in the system, allow read or write nv item
```

## xring-modules/drivers/ocm/Kconfig
```kconfig
config XRING_OCM
	tristate "XRING_OCM_CONFIG"
	default m
	help
	¦ ENABLE XRING_OCM_CONFIG
```

## xring-modules/drivers/pci/Kconfig
```kconfig
config XRING_PCIE
	tristate "support kernel PCIe"
	default m
	help
	  Say yes here to support kernel PCIe
	  This is the host driver.

	  This driver can also be built as a module.  If so, the module
	  will be called pcie-xring-host.

config XRING_PCIE_DEVICE
        tristate "support kernel PCIe device for test"
        default m
        help
          Say yes here to support kernel PCIe device for test
	  This is the device driver. For test only.

	  This driver can also be built as a module.  If so, the module
	  will be called pcie-xring-device.
```

## xring-modules/drivers/pcie_test/Kconfig
```kconfig
config XRING_PCIE_CYCLE
	tristate "support kernel PCIe sysfs"
	depends on XRING_DEBUG
	default m
	help
	  Say yes here to support kernel PCIe cycle mode.

config XRING_PCIE_EP
	tristate "support XRing PCIe EP controller"
	help
	  Say yes here to support bw PCIe EP bringup
	  This is bringup BW PCIe EP through spi. The driver is
	  running on soc chip, so linux PCIe framwork doesn't work.
	  This driver can also be built as a module.  If so, the module
	  will be called pcie-xring-ep.
```

## xring-modules/drivers/perf/Kconfig
```kconfig
menu "Xring perf"

source "../xring-modules/drivers/perf/flowctrl/Kconfig"
source "../xring-modules/drivers/perf/perf_actuator/Kconfig"
source "../xring-modules/drivers/perf/perf_monitor/Kconfig"
source "../xring-modules/drivers/perf/flowctrl_vote/Kconfig"

endmenu
```

## xring-modules/drivers/perf/flowctrl/Kconfig
```kconfig
# SPDX-License-Identifier: GPL-2.0-only
#
# sys flowctrl subsystem configuration
#

config XRING_SYS_FLOWCTRL
	tristate "XRING SYS FLOWCTRL driver"
	default m
	help
		Say yes here to Support sys flowctrl
```

## xring-modules/drivers/perf/flowctrl_vote/Kconfig
```kconfig
# SPDX-License-Identifier: GPL-2.0-only
#
# sys flowctrl_vote subsystem configuration
#

config XRING_SYS_FLOWCTRL_VOTE
	tristate "XRING SYS FLOWCTRL_VOTE driver"
	help
		Say yes here to Support sys flowctrl_vote
```

## xring-modules/drivers/perf/perf_actuator/Kconfig
```kconfig
# SPDX-License-Identifier: GPL-2.0-only
#
#

config XRING_PERF_ACTUATOR
        tristate "perf actuator interface"
	default n
        help
	  perf actuator
```

## xring-modules/drivers/perf/perf_monitor/Kconfig
```kconfig
config XRING_PERF_MONITOR
        tristate "Support for XRing perf"
        depends on XRING_DEBUG || XRING_DEBUG_TMP
        default m
```

## xring-modules/drivers/pinctrl/Kconfig
```kconfig
menu "Pinctrl Driver"
	comment "Settings about xring pinctrl driver"

config XRING_PINCTRL
	tristate "Xring core pin controller driver"
	depends on GPIO_GENERIC
	depends on GPIOLIB_IRQCHIP
	depends on PINCONF
	depends on PINMUX
	depends on GPIOLIB
	depends on IRQ_DOMAIN_HIERARCHY
	help
	  This is the pin controller core of the Xring. Include the following
	  modules:
	  pinconf: config the eletrical characteristic, such as pull up/down
	  pinmux: function multiplexing
	  gpiolib: merge the dwapb-gpio controller driver into pinctrl
	  Say m to enable the pinctrl of xring

config XRING_GPIO_DEBUG
	tristate "Support for XRing GPIO debug"
	depends on XRING_PINCTRL
	depends on DEBUG_FS
	help
	  Say yes here to Support XRing GPIO debug

endmenu
```

## xring-modules/drivers/pm_comm/Kconfig
```kconfig
config 	XRING_PM_COMM
	tristate "support sr/doze common use"
	depends on XRING_VOTE_MNG
	help
	  Say yes here to support kernel doze vote debug
```

## xring-modules/drivers/pmic/Kconfig
```kconfig
config XRING_PMIC
	tristate "support kernel pmic"
	help
	  Say yes here to support kernel pmic
config XRING_PMIC_SPMI
	tristate "support kernel pmic_spmi"
	default m
	help
	  Say yes here to support kernel pmic_spmi
config XRING_PMIC_RTC
	tristate "support kernel PMIC_RTC"
	default m
	help
	  Say yes here to support kernel pmic_rtc.
	  It does not provide registration to the rtc subsystem,
	  but only provides external interfaces.
	  The main consumer driver is soc rtc.
config XRING_PMIC_ADC
	tristate "support kernel PMIC_ADC"
	default m
	help
	  Say yes here to support kernel pmic_adc.
	  The adc mainly supports a bit width of 12 bits.
	  The adc driver is registered with the iio subsystem,
	  and provides the file node interface for read_raw.
config XRING_PMIC_RGB_LED
	tristate "support kernel PMIC_RGB_LED"
	default m
	help
	  Say yes here to support kernel pmic_rgb_led.
	  The led driver is registered in the led subsystem.
	  Provides three led devices,
	  and supports three modes.

config XRING_PMIC_MNTN
	tristate "Support for XRing PMIC maintanence"
	depends on XRING_PMIC_SPMI
	help
	  Say yes here to Support XRing PMIC maintanence.
	  This driver monitor and report the PMIC exceptions.

config XRING_PMIC_KEY
	tristate "support kernel pmic_key"
	help
	  Say yes here to support kernel pmic_key
```
