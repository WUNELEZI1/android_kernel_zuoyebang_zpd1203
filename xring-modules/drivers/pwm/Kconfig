## xring-modules/drivers/pwm/Kconfig
```kconfig
config XRING_PWM
	tristate "Support for XRing pwm"
	default m
	help
	  Say yes here to Support kernel pwm

config XRING_PWM_TEST
	tristate "Support for XRing pwm test"
	depends on XRING_PWM
	default m
	help
	  support for XRing pwm func test
```

## xring-modules/drivers/regulator/Kconfig
```kconfig
config XRING_REGULATOR
	tristate "Support for XRing regulator"
	help
	  Say yes here to Support XRing kernel regulator
config XRING_IP_REGULATOR
	tristate "Support for XRing ip regulator"
	default m
	help
	  Say yes here to Support kernel regulator

config XRING_PMIC_REGULATOR
	tristate "Support for XRing PMIC regulator"
	default m
	help
	  Say yes here to Support kernel PMIC regulator, to support power supply
	  from PMIC. Supported features: get/set voltage, get/set power mode,
	  enable/disable power. And currently, secure power not support yet,
	  and will be supported in the future

config XRING_BOB_REGULATOR
	default m
	tristate "Support for XRing BuckBoost regulator"
	help
	  Say yes here to Support kernel buckboost regulator
```

## xring-modules/drivers/reset/Kconfig
```kconfig
config XRING_RESET
	tristate "support kernel xring reset"
	depends on OF
	default m
	help
	  Say yes here to support kernel xring reset
	  This driver provides basic reset control api and register api,
	  and this must be checked for enabling reset operation for ip
	  working.

config XRING_RESET_O1
	tristate "Support for XRing O1 reset"
	depends on OF
	depends on XRING_RESET
	help
	  Say yes here to support O1 reset
	  This driver defines reset node and detail register information,
	  and this must be checked for O1 soc.
```

## xring-modules/drivers/rf_chip/Kconfig
```kconfig
config XRING_T_CHIP_GPIO
	tristate "XRING T chip"
	default n
	help
	This adds support for XRING T chip.
```

## xring-modules/drivers/rpmb/Kconfig
```kconfig
# SPDX-License-Identifier: GPL-2.0
# Copyright (c) 2015-2019, Intel Corporation.

config XRING_RPMB
	tristate "RPMB unit interface"
	help
	  Unified RPMB unit interface for RPMB capable devices such as
	  eMMC, UFS and NVME. Provides interface for in kernel security
	  controllers to access RPMB unit.

	  If unsure, select N.

config XRING_RPMB_INTF_DEV
	bool "RPMB character device interface /dev/rpmbN"
	depends on XRING_RPMB
	help
	  Say yes here if you want to access RPMB from user space
	  via character device interface /dev/rpmb%d
```

## xring-modules/drivers/rtc/Kconfig
```kconfig
config XRING_RTC
	tristate "support kernel RTC"
	default m
	help
	  Say yes here to support kernel RTC
```

## xring-modules/drivers/sensorhub/Kconfig
```kconfig
menu "Xring Sensorhub Module Driver"

config XRING_SH_DRV
	bool "support sensorhub functions in kernel side"
	default n
	help
	  support sensorhub functions in kernel side.
	  It is the root macro for sensorhub functions.
	  Every sensorhub function macro should depend on it.
	  If it is n, all the sensorhub functions shou1d be closed.

config XRING_SH_BOOT
	tristate "sensorhub boot"
	depends on XRING_SH_DRV
	default n
	help
		support sensorhub boot/dts and so on.
		If it is m, the sensorhub boot function would be builded.
		It depends on the sensorhub root macro XRING_SH_DRV.
		Open it in the gki.fragment file.

config XRING_SH_RESET_DRV
	tristate "support sensorhub reset function"
	depends on XRING_SH_DRV
	default n
	help
	  support sensorhub reset function in kernel side.
	  If it is m, the sensorhub reset function would be builded.
	  It depends on the sensorhub root macro XRING_SH_DRV.
	  Open it in the gki.fragment file.

config XRING_SH_SENSOR
	tristate "sensorhub sensor"
	depends on XRING_SH_DRV
	default n
	help
		support sensorhub sensor function.
		If it is m, the sensorhub boot function would be builded.
		It depends on the sensorhub root macro XRING_SH_DRV.
		Open it in the gki.fragment file.

source "../xring-modules/drivers/sensorhub/ipc/Kconfig"
source "../xring-modules/drivers/sensorhub/connectivity/Kconfig"
source "../xring-modules/drivers/sensorhub/firq/Kconfig"
source "../xring-modules/drivers/sensorhub/framework/app_router/Kconfig"
source "../xring-modules/drivers/sensorhub/framework/direct_channel/Kconfig"
source "../xring-modules/drivers/sensorhub/framework/sensor_power_manager/Kconfig"
source "../xring-modules/drivers/sensorhub/framework/aoc_dump/Kconfig"
source "../xring-modules/drivers/sensorhub/chre/Kconfig"

endmenu
```

## xring-modules/drivers/sensorhub/chre/Kconfig
```kconfig
config XRING_SH_CHRE_ROUTER
	tristate "support CHRE channel for sensorhub"
	depends on XRING_SH_DRV && XRING_DEBUG
	default m
	help
	  This enables the XRing CHRE Channel.
```

## xring-modules/drivers/sensorhub/connectivity/Kconfig
```kconfig
config XRING_SH_CONN_IPC
	tristate "sensorhub conn status function"
	depends on XRING_SH_DRV
	depends on XRING_IPC
	depends on XRING_SH_IPC
	default n
	help
	  Support sensorhub connectivity ipc in kernel.
	  If it is m, it would be builded.
	  It depends on the sensorhub root macro XRING_SH_DRV,
	  XRING_IPC and XRING_SH_IPC.
	  Open it in the gki.fragment file.
```

## xring-modules/drivers/sensorhub/firq/Kconfig
```kconfig
config XRING_FIRQ
	tristate "support sensorhub to ap firq"
	depends on XRING_SH_DRV
	default n
	help
	  This enables the XRing firq driver.
```

## xring-modules/drivers/sensorhub/framework/aoc_dump/Kconfig
```kconfig
config XRING_SH_AOC_DUMP
	tristate "support aoc dump for sensorhub"
	depends on XRING_DEBUG || XRING_DEBUG_TMP
	default m
	help
	  This enables the XRing AOC dump.
	  It depends on the sensorhub root macro XRING_SH_DRV.
```

## xring-modules/drivers/sensorhub/framework/app_router/Kconfig
```kconfig
config XRING_SH_APP_ROUTER
	tristate "support app router for sensorhub"
	depends on XRING_SH_DRV
	depends on XRING_SH_IPC
	depends on XRING_SH_BOOT
	default n
	help
	  This enables the XRing App Router, needed by sensrhal.
	  It depends on the sensorhub root macro XRING_SH_DRV and
	  XRING_SH_IPC and XRING_SH_BOOT.

config XRING_SH_APP_ROUTER_RESET_SENSOR_POWER
	tristate "enable app router reset sensor power"
	depends on XRING_SH_APP_ROUTER
	default n
	help
	  This enables the XRing App Router reset sensor power.
```

## xring-modules/drivers/sensorhub/framework/direct_channel/Kconfig
```kconfig
config XRING_SH_DIRECT_CHANNEL
	tristate "support direct channel for sensorhub"
	depends on XRING_SH_DRV
	help
	  This enables the XRing Direct Channel.
	  It depends on the sensorhub root macro XRING_SH_DRV.
```

## xring-modules/drivers/sensorhub/framework/sensor_power_manager/Kconfig
```kconfig
config XRING_SH_SENSOR_POEWR_MANAGER
	tristate "support sensor power manager"
	depends on XRING_SH_DRV
	depends on XRING_SH_BOOT
	depends on XRING_DEBUG || XRING_DEBUG_TMP
	default m
	help
	  This enables the XRing Sensor Power Manager.
	  It depends on the sensorhub root macro XRING_SH_DRV,
	  and XRING_SH_BOOT.
```

## xring-modules/drivers/sensorhub/ipc/Kconfig
```kconfig
config XRING_SH_IPC
	tristate "support ipc protocol for sensorhub"
	depends on XRING_SH_DRV
	depends on XRING_IPC
	default n
	help
	  Say yes here to support sensorhub ipc
	  If it is m, the sensorhub ipc function would be builded.
	  It depends on the sensorhub root macro XRING_SH_DRV and XRING_IPC.
	  Open it in the gki.fragment file.
```

## xring-modules/drivers/smmu/Kconfig
```kconfig
menu "XRING SMMU"

config XRING_SMMU
        tristate "XRING SMMU Driver"
        depends on IOMMU_SUPPORT
        help
          Choose this option to enable xring arm smmu driver.
          media1, media2, npu, pcie ip module have smmu, when smmu driver
          enabled, masters can get iova instead of pa, and then use iova
          for transfer, smmu receive iova from master and transfer it to phy

config XRING_SMMU_PMU
        tristate "XRING SMMU PMU Driver"
        depends on IOMMU_SUPPORT
        help
          Choose this option to enable xring arm smmu pmu driver.
          when smmu pmu driver enabled, user can check cycles/transaction/
          tlb_miss/config_cache_miss/trans_table_walk_access/config_struct_access
          those parameters, with those parameters, we can see performance of
          masters and according to those parameters, improve performance of master.

config XRING_DUMMY_SMMU
        tristate "XRING Dummy SMMU Driver"
        depends on IOMMU_SUPPORT
        help
          Choose this option to enable xring dummy smmu driver.
          If soc or fpga don't have smmu hardware but user still want to use
          smmu function, enable this config, after, when you get dma_addr by
          iommu API, you need to convert it to phys by iommu_iova_to_phys().
          If you want to use heap with dummy smmu you should also enable config
          XRING_DMA_IOMMU, after, when you get dma-buf from heap, you have
          dma_addr already converted to phys, and use that phys for dma.

config XRING_SMMU_DOMAIN_SHARE
        tristate "XRING SMMU DOMAIN"
        depends on IOMMU_SUPPORT
        help
          Choose this option to enable xring smmu domain feature.
          After turning on this option, if the master wants to use SMMU,
          it needs to configure <group sid ssid> in the iommus field of dts.
          use the same domain by configuring the same sid in DTS.

config XRING_IOMMU_MAP
        tristate "XRING IOMMU DMA Support"
        depends on IOMMU_SUPPORT
        help
          Choose this option to enable xring iommu apis.
          After turning on this option, all dma_map_ops functions will be
          replaced by xring_iommu_dma_ops functions implemented by xring.
          The implementation of these functions is in the file xring_iommu_map.c

config XRING_SMMU_DUMP_PGTABLE
        tristate "XRING SMMU PGTABLE DUMP Support"
        depends on IOMMU_SUPPORT
        help
          Choose this option to enable xring smmu dump pgtable.
          This option is mainly used to enhance the dimensionality of SMMU.
          After turning on this option, when SMMU generates an event,
          SMMU's stream table will be dumped.

config XRING_SMMU_TCU_TBU_RECONSTRUCT
        tristate "XRING SMMU TCU TBU RECONSTRUCT"
        depends on IOMMU_SUPPORT
        help
          Choose this option to enable xring smmu tcu tbu new link up/down code.
          When this option is turned on, the software part of the SMMU driver is
          isolated from the hardware part, and an error handling mechanism is
          added when hardware operations need to be performed.

config XRING_SMMU_DEBUGFS
        tristate "XRING SMMU DEBUGFS Support"
        depends on IOMMU_SUPPORT
        help
          Choose this option to enable xring smmu debugfs.
          When this option is turned on, a debugfs node will be created,
          which can be used to dump SMMU's stream table and SMMU-managed
          iova information.

config XRING_SMMU_CONTIGUOUS
        tristate "XRING SMMU CONTIGUOUS"
        default n
        help
          Choose this option to enable xring smmu contiguous.
          When this option is turned on, xr_smmu_contiguous, the heap
          order adds 9-2m requests, and smmu uses contiguous bit and
          block mapping when establishing the mapping.
endmenu
```

## xring-modules/drivers/spi/Kconfig
```kconfig
config XRING_SPI
	tristate "support kernel spi"
	default m
	help
	  Say yes here to support kernel spi
```

## xring-modules/drivers/spmi/Kconfig
```kconfig
config XRING_SPMI
	tristate "support kernel spmi"
	default m
	select REGMAP_SPMI
	help
	  Say yes here to support kernel spmi
```

## xring-modules/drivers/tee/Kconfig
```kconfig
# SPDX-License-Identifier: GPL-2.0-only
# Generic Trusted Execution Environment Configuration
config XRING_TEE
	tristate "Trusted Execution Environment support"
	depends on HAVE_ARM_SMCCC || COMPILE_TEST || CPU_SUP_AMD
	depends on CRYPTO
	depends on CRYPTO_SHA1
	depends on DMA_SHARED_BUFFER
	depends on GENERIC_ALLOCATOR
	help
	  This implements a generic interface towards a Trusted Execution
	  Environment (TEE).

if XRING_TEE

menu "TEE drivers"

config XRING_MITEE_SUPPORT
	tristate "Enable MITEE Support"
	help
	  This implements the MI-TEE Trusted Execution Environment (TEE)
	  driver.

config XRING_TEE_GP_SUPPORT
	bool "Enable GlobalPlatform support in TEE related modules"
	default n
	depends on XRING_MITEE_SUPPORT
	help
	  GlobalPlatform defines common/consistent APIs and this option
	  enables TEE related modules to use GPAPIs. (depending on
	  Xiao Mi TEE or other 3rd-party TEE)

config XRING_OPTEE_SHM_NUM_PRIV_PAGES
	int "Private Shared Memory Pages"
	default 1
	depends on XRING_MITEE_SUPPORT
	help
	  This sets the number of private shared memory pages to be
	  used by MITEE TEE driver.

config XRING_OPTEE_BENCHMARK
	bool "MITEE Benchmark (EXPERIMENTAL)"
	depends on XRING_MITEE_SUPPORT
	help
	  This enables benchmarking feature in the MITEE Trusted
	  Execution Environment (TEE) driver.

config XRING_MITEE_MEMORY_MONITOR
	tristate "Enable TEE memory monitor"
	depends on MIEV
	default n
	help
	  Type Y here to build support for the memory monitor of TEE,
	  the memory status of TEE memory will be pushed to onetrack platform.
endmenu

endif
```

## xring-modules/drivers/tee/mitee/tui/Kconfig
```kconfig
# MITEE TUI Configuration
config XRING_MITEE_TUI_SUPPORT
	tristate "Enable MITEE TUI"
	depends on XRING_MITEE_SUPPORT
	help
	  this is used to support mitee tui driver
```

## xring-modules/drivers/test/sample_kernel_ca/Kconfig
```kconfig
# TEE Sample Kernel CA Configuration
config XRING_TEE_SAMPLE_KERNEL_CA
	tristate "Enable Sample Kernel CA"
	depends on XRING_TEE
	depends on XRING_MITEE_SUPPORT
	help
	  This implements the Sample Kernel CA driver.
```

## xring-modules/drivers/thermal/Kconfig
```kconfig
config XRING_THERMAL
	tristate "Support for XRing thermal"
	depends on THERMAL_OF
	help
	  Say yes here to Support xring thermal

config XRING_SOC_THERMAL
	tristate "Support for XRing soc thermal"
	depends on THERMAL_OF && XRING_THERMAL
	help
	  Say yes here to Support xring soc thermal

config XRING_VIRTUAL_THERMAL
	tristate "Support for XRing virtual sensor"
	depends on THERMAL_OF && XRING_SOC_THERMAL
	help
	  Say yes here to Support xring virtual sensor

config XRING_BOARD_THERMAL
	tristate "Support for XRing board thermal"
	depends on THERMAL_OF && XRING_THERMAL
	help
	  Say yes here to Support xring board thermal

config XRING_CPUFREQ_CDEV
	tristate "Support for XRing CPUfreq cooling device"
	depends on THERMAL_OF
	default n
	help
	  Say yes here to Support CPUfreq cooling device

config XRING_CPU_HOTPLUG_CDEV
	tristate "CPU Hotplug cooling devices"
	depends on THERMAL && HOTPLUG_CPU
	help
	   This enables the CPU Hotplug cooling devices.

config XRING_CPU_PAUSE_CDEV
	tristate "CPU Pause cooling devices"
	depends on THERMAL_OF && HOTPLUG_CPU
	help
	   This enables the CPU Pause cooling device.

config XRING_GPUFREQ_CDEV
	tristate "GPUfreq cooling device"
	depends on PM_DEVFREQ && THERMAL && PM_OPP
	help
	   This enables the gpufreq cooling device.

config XRING_GPU_HOTPLUG_CDEV
	tristate "GPU Hotplug cooling devices"
	depends on THERMAL
	help
	   This enables the GPU Hotplug cooling devices.
```

## xring-modules/drivers/timer/Kconfig
```kconfig
config XRING_TIMER
	tristate "Support for XRing timer"
	default m
	help
	  Say yes here to Support kernel timer
```

## xring-modules/drivers/timestamp/Kconfig
```kconfig
config XRING_TIMESTAMP
	tristate "support kernel xring timestamp"
	default m
	help
	  Say yes here to support kernel xring timestamp
```

## xring-modules/drivers/typec/Kconfig
```kconfig
# SPDX-License-Identifier: GPL-2.0

menuconfig XRING_TYPEC_STUB
	bool "USB Type-C Driver Support for SOC Verify"
	default n
	help
	  Build the driver to enable USB Type-C function.
	  This driver offer analog audio switch and 5V on VBus.

if XRING_TYPEC_STUB
source "../xring-modules/drivers/typec/audio_switch/Kconfig"
source "../xring-modules/drivers/typec/pd/Kconfig"
endif
```
