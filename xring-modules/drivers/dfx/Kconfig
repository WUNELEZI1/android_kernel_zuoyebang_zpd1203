## xring-modules/drivers/dfx/Kconfig
```kconfig
config XRING_DFX
	tristate "Support for XRing dfx"

config XRING_TRACE_HOOK
	tristate "Support for XRing hook"

config XRING_SMC_TRACE_TEST
	tristate "Support for XRing smc trace test"
	depends on XRING_DEBUG || XRING_DEBUG_TMP
	default m

config XRING_DFX_SWITCH
	tristate "Support kernel dfx_switch"
	help
	  Say yes here to support kernel dfx_switch

config XRING_MDR
	tristate "Support for XRing mdr"
	depends on XRING_DFX_SWITCH
	default m
	help
	  mdr module is design for subsystem to register reset and logdump callback

config XRING_REBOOT_REASON
        tristate "Support for reboot reason"
	depends on XRING_MDR
        default m

config XRING_FASTBOOTLOG_SAVE
        tristate "Support for XRing fastbootlog save"

config XRING_MEMDUMP
        tristate "Support for XRing memory dump"

config XRING_MEMDUMP_TEST
        tristate "Support for XRing memory dump test"
        depends on XRING_MEMDUMP && (XRING_DEBUG || XRING_DEBUG_TMP)
        default m

config XRING_MDR_TEST
	tristate "Support for XRing mdr test"
	depends on XRING_MDR && (XRING_DEBUG || XRING_DEBUG_TMP)
```

## xring-modules/drivers/dfx_bootup/Kconfig
```kconfig
config XRING_BOOTUP_STAGE1
	tristate "Support for bootup stage1"
	help
	  xr-bootup-stage1 module is design for refresh
	  keypoint during kernel vendor boot
	  and provides the file node interface
	  Say yes here to support the module
config XRING_BOOTUP_STAGE2
	tristate "Support for bootup stage2"
	help
	  xr-bootup-stage2 module is design for
	  refresh keypoint during
	  kernel super boot
	  Say yes here to support the module
```

## xring-modules/drivers/display/Kconfig
```kconfig
source "../xring-modules/drivers/display/dpu/Kconfig"
source "../xring-modules/drivers/display/ade/Kconfig"
```

## xring-modules/drivers/display/ade/Kconfig
```kconfig
# SPDX-License-Identifier: GPL-2.0-only

config XRING_ADE
	tristate "support for Xring ADE"
	default m
	help
		Choose this option if you have a XRing ADE.
		If M is selected the module will be called xring-ade.
```

## xring-modules/drivers/display/dpu/Kconfig
```kconfig
# SPDX-License-Identifier: GPL-2.0-only

config DRM_XRING
	tristate "DRM support for Xring DPU"
	depends on DRM
	depends on DRM_KMS_HELPER
	select DRM_DISPLAY_HELPER
	select DRM_DISPLAY_DP_HELPER
	default m
	help
	  Choose this option if you have a XRing DPU.
	  If M is selected the module will be called xring-drm.
```

## xring-modules/drivers/dma/Kconfig
```kconfig
config XRING_DW_AXI_DMA
	tristate "X-Ring DesignWare AXI DMA support"
	help
	  Enable support for Synopsys DesignWare AXI DMA controller.
	  NOTE(From Synopsys): This driver wasn't tested on 64 bit platform because
	  of lack 64 bit platform with Synopsys DW AXI DMAC.
	  But Xiaomi will solve that problem.
```

## xring-modules/drivers/doze/Kconfig
```kconfig
config 	XRING_DOZE
	tristate "support kernel doze vote"
	depends on XRING_PM_COMM
	help
	  Say yes here to support kernel doze vote debug
```

## xring-modules/drivers/dse/Kconfig
```kconfig
config XRING_DSE
	tristate "Support for XRing Design Space Exploration Driver"
	default n
	help
	  This enables the XRing Design Space Exploration Driver.
```

## xring-modules/drivers/dsu_pmu/Kconfig
```kconfig
config XRING_DSU_PMU
	tristate "XRing DSU PMU"
	depends on ARM64
	help
	  Provides support for performance monitor unit in ARM DynamIQ Shared
	  Unit (DSU). The DSU integrates one or more cores with an L3 memory
	  system, control logic. The PMU allows counting various events related
	  to DSU.

config XRING_DSU_PMU_CYCLE_COUNTER
	bool "XRing DSU PMU CYCLE COUNTER"
	depends on XRING_DSU_PMU
	help
	  Provides support for cycle counter of performance monitor unit
	  in ARM DynamIQ Shared Unit (DSU). If enable this feature, assign
	  the cycle counter for cycle event. Otherwise, assign an event
	  counter for cycle event.

config XRING_DSU_PMU_EVENT_COUNTER_64BITS
	bool "XRing DSU PMU 64BITS EVENT COUNTER"
	depends on XRING_DSU_PMU
	help
	  Provides support for 64bits event counter of performance monitor unit
	  in ARM DynamIQ Shared Unit (DSU). If not enable this feature,
	  event counter is 32bits at default. And cycle counter always is
	  64bits if support.
```

## xring-modules/drivers/efuse/Kconfig
```kconfig
config XRING_EFUSE
	tristate "support kernel efuse"
	default m
	help
	  Say yes here to support kernel efuse
```

## xring-modules/drivers/fbe/Kconfig
```kconfig
# XRing FBE Kernel CA Configuration
config XRING_FBE
	tristate "FBE Kernel CA"
	depends on XRING_MITEE_SUPPORT
	help
	  Android 7.0 and higher supports file-based encryption (FBE).File-based
	  encryption allows different files to be encrypted with different keys
	  that can be unlocked independently.All devices launching with Android 10
	  and higher are required to use file-based encryption.
	  Say Y or M here to enable the XRing FBE feature.

config XRING_FBE_TEST
	tristate "Enable FBE Kernel CA test"
	depends on XRING_FBE
	help
	  Say Y or M here to build support for the test of XRing FBE Kernel CA.
	  The test is triggered by "ecall" command.

config XRING_MODEL_TEST
	tristate "Enable Model Protection Kernel CA test"
	depends on XRING_FBE
	help
	  Say Y or M here to build support for the test of XRing Model Protection Kernel CA.
	  The test is triggered by "ecall" command.
```

## xring-modules/drivers/fts_spi/Kconfig
```kconfig
config XRING_FTS
	tristate "support kernel spi_fts"
	default m
	help
	  Say yes here to support kernel spi_fts
```

## xring-modules/drivers/gpu/arm/Kconfig
```kconfig
choice
    prompt "xring gpu choice"
    default MALI_TKRX_V
    help
      choose gpu product

config MALI_TKRX
    bool "Mali TKRX configs"

config MALI_TKRX_V
    bool "Mali TKRX_V configs"

config MALI_DO_NOTHING
    bool "do nothing"
endchoice

menu "X-Ring GPU Configuration"

if MALI_TKRX_V
source "../xring-modules/drivers/gpu/arm/avalon_r49p1-04eac0/Kconfig"
endif

endmenu
```

## xring-modules/drivers/gpu/arm/avalon_r49p1-04eac0/platform/xring/Kconfig
```kconfig
# SPDX-License-Identifier: GPL-2.0 WITH Linux-syscall-note
#
# (C) COPYRIGHT 2012-2023 ARM Limited. All rights reserved.
#
# This program is free software and is provided to you under the terms of the
# GNU General Public License version 2 as published by the Free Software
# Foundation, and any use by you of this program is subject to the terms
# of such GNU license.
#
# This program is distributed in the hope that it will be useful,
# but WITHOUT ANY WARRANTY; without even the implied warranty of
# MERCHANTABILITY or FITNESS FOR A PARTICULAR PURPOSE. See the
# GNU General Public License for more details.
#
# You should have received a copy of the GNU General Public License
# along with this program; if not, you can access it online at
# http://www.gnu.org/licenses/gpl-2.0.html.
#
#
config MALI_XR_MEMREPAIR_ENABLE
	bool "Enable xr gpu power on memory repair"
	depends on MALI_MIDGARD
	default n
	help
	  Enable xr gpu power on memory repair function.
	  If xr gpu need memory repair, say Y.

config MALI_XR_MDR
	bool "Enable xr mdr"
	depends on MALI_MIDGARD
	default n
	help
	  Enable xr mdr.

config MALI_XR_GPU_POWER_BACKUP
	bool "Enable gpu power backup"
	depends on MALI_MIDGARD
	default n
	help
	  Enable bare configuration registers implement gpu power on and off.
	  It is necessary to verify the poweron/off functional design of the gpu is OK.
	  If chip verification is required, say Y.

config MALI_XR_GPU_POWER_SOFTWARE
	bool "Enable gpu power backup by software"
	depends on MALI_MIDGARD
	default n
	help
	  Enable bare configuration registers implement gpu power on and off.
	  It is necessary to verify the poweron/off functional design of the gpu is OK.
	  If chip verification is required, say Y.

config MALI_XR_GPU_DISARRANGE
	bool "Enable AFBC DISARRANGE"
	depends on MALI_MIDGARD
	default n
	help
	  Enable AFBC DISARRANGE

config MALI_XRING_CL_DVFS
	bool "GPU CSF CL boost enable"
	depends on MALI_CSF_SUPPORT && MALI_MIDGARD_DVFS
	default n
	help
	  This option sets Xring GPU CL Boost DVFS enable.
	  When CSF-based GPU need open OpenCL Boost policy,open this config
	  and makesure DVFS is OK

	  If sure DVFS is ready and open CL Boost, say Y.

config MALI_XR_CORE_HOTPLUG
	bool "Enable gpu core hotplug"
	depends on MALI_MIDGARD
	default n
	help
	  Enable gpu core hotplug

config MALI_XR_SMART_GAMING
	bool "Enable smart gaming feature"
	depends on MALI_MIDGARD && XRING_PERF_ACTUATOR && MALI_XR_CORE_HOTPLUG
	default n
	help
	  Enable smart gaming feature, query hardware counters and frame rate.

config MALI_XR_PROP_VISIBLE
	bool "Enable show gpu property"
	depends on MALI_MIDGARD
	default n
	help
	  Enable show gpu property

config MALI_XR_GPU_PROTECTED_MEMORY
	bool "Enable GPU PROTECTED MEMORY"
	depends on MALI_MIDGARD
	default n
	help
	  Enable GPU PROTECTED MEMORY

config MALI_XR_VIRTUAL_DEVFREQ
	bool "Enable xr virtual frequency"
	depends on MALI_MIDGARD && MALI_MIDGARD_DVFS && MALI_XR_CORE_HOTPLUG
	default n
	help
	  Virtual frequency is implemented by dynamic core scaling.
	  It is used to saving power at low workload scene.
	  If in doubt, say No.

config MALI_XR_THERMAL_CONTROL
	bool "Enable gpu core hotplug in high temperature scene"
	depends on MALI_XR_CORE_HOTPLUG
	default n
	help
	  This policy reduces the gpu power consumption by shutdown gpu cores
	  If in doubt, say No.

config MALI_XR_GPU_DEBUG
	bool "Enable xr gpu common debug"
	depends on MALI_MIDGARD
	default n
	help
	  It is used to collect debug information on CS_FAULT/PAGE_FAULT etc.
	  If in doubt, say No.
```

## xring-modules/drivers/gpufreq/Kconfig
```kconfig
config XRING_GPU_DEVFREQ
	tristate "support kernel gpufreq"
	help
	  Say yes here to support kernel gpu devfreq
```

## xring-modules/drivers/heaps/Kconfig
```kconfig
menu "XRING DMA-BUF"

config XRING_DMABUF_HEAPS_SYSTEM
        tristate "XRING DMA-BUF System Heap"
        depends on DMABUF_HEAPS
        help
          Choose this option to enable dma-buf System heap.
          When enable this option, you will get /dev/dma_heap/system
          When alloc from System Heap, you will get dma-buf which is
          physically contiguous or not contiguous.

config XRING_DMABUF_HEAPS
        tristate "XRING DMA-BUF Xring Heap"
        depends on DMABUF_HEAPS && GENERIC_ALLOCATOR
        help
          Choose this option to enable dma-buf Multi heap. This heap is
          backed by the Generic Allocator.
          When enable this option, you will get many char device in /dev/dma_heap
          When alloc from these heap like cma heap or system heap
          you will get dma-buf which is physically contiguous.

config XRING_DMA_IOMMU
        tristate "XRING DMA IOMMU"
        help
          Choose this option to enable xring specific dma iommu function
          map_lazy function which support different dev in the same iommu
          domain share mapped info of the same dma-buf, this will avoid repeat
          map of iova and pa.

config XRING_NEED_CHANGE_MAPPING
        bool "XRING Need Change Mapping"
        depends on XRING_DMABUF_HEAPS
        help
          Choose this option to change memory property from normal memory to
          device memory, this will avoid speculate access in using protected

config XRING_DMABUF_HEAPS_TEST_DRIVER
        tristate "DMA-BUF Heap Test Driver"
        depends on DMABUF_HEAPS
        help
          Choose this option to enable dma-buf heap test driver.

config XRING_HEAP_DEBUG
        bool "XRING HEAP DEBUG"
        depends on XRING_DMABUF_HEAPS
        help
          Choose this option to enable xring heap debug,
          this will print all xring heaps.
          And print xring heaps information include
          name, base and size in /sys/devices/platform/xring_multi_heaps.

config XRING_SECURE_HEAP
        bool "XRING SECURE HEAP"
        depends on XRING_MITEE_SUPPORT
        default n
        help
          Choose this option to enable secure heap.
          rigth now, we support xring_cpa for DRM, xring_isp_faceid
          for faceid sence, xring_npu_dym for npu user case,
          xring_tui_font and xring_tui_display for trust ui sence.

config XRING_HEAP_ALLOC_MAX_TIMEOUT
        bool "XRING HEAP ALLOC MAX TIMEOUT"
        depends on XRING_DMABUF_HEAPS
        help
          Choose this option to indicate this is a slow machine.
          This will set max timeout of heap allocation.
          If not set this option, xring meminfo module will print info
          when heap spends too much time on allocation.

config XRING_HEAP_NOC_DFX
        bool "XRING HEAP NOC DFX"
        depends on XRING_DMABUF_HEAPS
        default n
        help
          Selecting this option indicates that this is a machine with NOC anomalies.
          Here, each dynamic protection/security memory will be labeled on the kernel
          side to check who remaps the protection or security memory on the kernel side.
          This option is only enabled in the eng version and is not set in the user version.

endmenu
```

## xring-modules/drivers/hpc/Kconfig
```kconfig
menu "X-Ring HPC Device"

config XRING_HPC_MBOX
	tristate "HPC MBOX driver"
	default n
	depends on OF
	help
		Choose this option to enable HPC Mailbox driver.

config XRING_HPC
	tristate "HPC driver"
	default n
	depends on OF
	depends on XRING_HPC_MBOX
	depends on XRING_RPMSG_VIRTIO
	help
		Choose this option to enable HPC driver.

if XRING_HPC
source "../xring-modules/drivers/hpc/hrp/Kconfig"
source "../xring-modules/drivers/hpc/mitee_crypto/Kconfig"
endif

config XRING_XRP
	tristate "HPC XRP driver"
	default n
	depends on OF
	help
		Choose this option to enable XRP driver.

if XRING_XRP
source "../xring-modules/drivers/hpc/xrp/Kconfig"
endif

endmenu
```

## xring-modules/drivers/hpc/hrp/Kconfig
```kconfig
if XRING_HPC

config XRING_HPC_DEVICE
	tristate "HPC device"
	default n
	help
		Choose this option to enable hpc boot device

config XRING_HPC_CDEV
	tristate "HPC char device"
	default n
	help
		Choose this option to enable hpc char device

config XRING_HPC_RPMSG
	tristate "HPC rpmsg device"
	default n
	help
		Choose this option to enable hpc char device

config XRING_HPC_HEAP
	tristate "HPC heap device"
	default n
	help
		Choose this option to enable hpc heap device

endif
```

## xring-modules/drivers/hpc/mitee_crypto/Kconfig
```kconfig
if XRING_HPC

config XRING_HPC_MITEE_CRYPTO
	tristate "HPC mitee crypto device"
	default n
	help
		Choose this option to enable hpc mitee crypto device

endif
```

## xring-modules/drivers/hwspinlock/Kconfig
```kconfig
config XRING_HWLOCK
	tristate "support kernel HWLock"
	default m
	help
	  Say yes here to support kernel HWLock
```
