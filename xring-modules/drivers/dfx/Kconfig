## xring-modules/drivers/i2c/Kconfig
```kconfig
menu "I2C Drivers"
	comment "Settings about xring xring-i2c module"

config XRING_DW_APB_I2C
	tristate "X-Ring DesignWare APB I2C support"
	help
	  If you say yes to this option, support will be included for the
	  X-Ring DesignWare I2C adapter.
	  This driver can also be built as a module.  If so, the module
	  will be called i2c-designware-platform.

config XRING_I2C_DESIGNWARE
	bool "X-Ring I2C features"
	depends on XRING_DW_APB_I2C
	default y
	help
	  XRing IP self-developed features.
	  Because TX and RX FIFO have the same depth,
	  corresponding software features include:

	  TX FIFO EMPTY Interrupt threshold: half TX FIFO depth
	  RX FIFO FULL interrupt threshold: TX FIFO EMPTY interrupt threshold half
	  (RX FIFO depth 1/4)

	  Dynamic RX FIFO FULL interrupt threshold adjustment.

config XRING_I2C_DMA
	bool "X-Ring I2C DMA"
	depends on XRING_DW_APB_I2C
	depends on XRING_I2C_DESIGNWARE
	default y
	help
	  If you say yes to this option,
	  The X-Ring I2C will support DMA functionality.
	  If the IP supports DMA, then the driver will use DMA
	  depending on the amount of data.

config XRING_I2C_DEBUGFS
	bool "X-Ring I2C debugfs"
	depends on XRING_DW_APB_I2C
	depends on DEBUG_FS
	default y
	help
	  If this value is set to y, the X-Ring i2c driver will enable the debugfs feature.
	  The corresponding debug file node of the file system is:

	  debugfs support is provided: /sys/kernel/debugfs/xring-i2c-x

	  Through the debugfs file node, you can view the register configuration information
	  of the i2c controller in the current state.

endmenu
```

## xring-modules/drivers/i2c_dev/Kconfig
```kconfig
config XRING_I2C_CHARDEV
	tristate "I2C device interface"
	depends on XRING_DW_APB_I2C
	help
	  Say Y here to use i2c-* device files, usually found in the /dev
	  directory on your system.  They make it possible to have user-space
	  programs use the I2C bus.  Information on how to do this is
	  contained in the file <file:Documentation/i2c/dev-interface.rst>.

	  This support is also available as a module.  If so, the module
	  will be called i2c-dev.
```

## xring-modules/drivers/ipc/Kconfig
```kconfig
menu "Xring IPC"

config XRING_IPC
	tristate "support kernel ipc"
	help
	  Say yes here to support kernel ipc

config XRING_IPC_PROT
	tristate "support kernel ipc protocol"
	depends on XRING_IPC
	help
	  Say yes here to support kernel ipc protocol

config XRING_IPC_HOOK
	tristate "Support kernel xring ipc hook"
	depends on XRING_TRACE_HOOK && (XRING_DEBUG || XRING_DEBUG_TMP)
	default m

endmenu
```

## xring-modules/drivers/kmod_protect/Kconfig
```kconfig
config XRING_KMOD_PROTECT
	tristate "support protection for kernel module"
	default n
	help
	  Say yes here to support protection for kernel module
```
