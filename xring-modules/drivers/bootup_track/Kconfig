## xring-modules/drivers/bootup_track/Kconfig
```kconfig
config XRING_BOOTUP_TRACK_STAGE1
	tristate "Support bootup time track on stage1"
	help
	  records kernel init time to dfx memory
	  Say yes here to support the module
config XRING_BOOTUP_TRACK_STAGE2
	tristate "Support bootup time track on stage2"
	help
	  create a proc node to be written in
	  android boot. records android boot time
	  and report auth and boot timeout event
	  on write.
	  Say yes here to support the module
```

## xring-modules/drivers/camera/Kconfig
```kconfig
menu "ISP Drivers"
config XRING_ISP
	tristate "XRing ISP V4L2 interface"
	help
	  This is a V4L2 driver for XRing ISP
config XRING_ISP_REGULATOR
	tristate "Support for XRing isp regulator register and test"
	depends on XRING_IP_REGULATOR
	help
	  ISP regulator register and test
config XRING_ISP_EDR_TRACE
	bool "support ramtrace and ramprof"
	default n
	help
	  support isp systrace and ramprof function

config XRING_CAMSKY
	tristate "XRing SKY"
	depends on XRING_ISP
	help
	  This is XRing ISP edr scheme

source "../xring-modules/drivers/camera/cam_sensor_pm/wl28681c/Kconfig"
source "../xring-modules/drivers/camera/cam_sensor_pm/wl28661d/Kconfig"
endmenu
```

## xring-modules/drivers/camera/cam_sensor_pm/wl28661d/Kconfig
```kconfig
config XRING_WL28661D_LDO
	tristate "Support for XRing WL28661D LDO"
	help
	  Say yes here to Support kernel WL28661D LDO
```

## xring-modules/drivers/camera/cam_sensor_pm/wl28681c/Kconfig
```kconfig
config XRING_WL28681C_LDO
	tristate "Support for XRing WL28681C LDO"
	help
	  Say yes here to Support kernel WL28681C LDO
```

## xring-modules/drivers/clk/Kconfig
```kconfig
config XRING_CLK_COMMON
	tristate "Support for XRing Clock Common Logic"
	depends on OF
	default m

config XRING_CLK
	tristate "Support for XRing clock"
	depends on OF
	select XRING_CLK_COMMON

if XRING_CLK

config XRING_CLK_ALWAYS_ON
	bool "XRing Clock Alwayson Feature"
	default n
	help
	  Support for clocks always on.
	  Say Y if you want to the clock will not be turned off.

endif

config XRING_CLK_O1
	tristate "Support for XRing O1 clock"
	depends on OF
	select XRING_CLK
	help
		Build the driver for XRing O1 Clock Driver

config XRING_CLK_PM_MONITOR
	bool "Support for XRing O1 clock pm monitor"
	depends on XRING_CLK
	help
	  Build the driver for XRing O1 Clock Pm Monitor.
	  this module check clocks before system suspend,if the Clock
	  that we care is enabled, we would print the clock's name.

	  To compile this driver as a module, choose y here.

config XRING_CLK_PM_RESET_SYS
	bool "XRing Clock Pm monitor reset system"
	depends on XRING_CLK_PM_MONITOR
	default n
	help
	  Support for clk pm monitor reset system.
	  this config may influence the system
	  stability, please consider it carefully.

	  Say Y if you want to reset system when find clock enabled.

config XRING_CLK_MEDIADVFS
	tristate "Support for XRing O1 Media DVFS"
	depends on OF
	select XRING_CLK_COMMON
	help
		Build the Media DVFS driver for XRing O1 Clock Driver

config XRING_CLK_PERIDVFS
	tristate "Support for XRing O1 Peri DVFS"
	depends on OF
	select XRING_CLK_COMMON
	help
		Build the Peri DVFS driver for XRing O1 Clock Driver

config XRING_CLK_FAST_DFS
	bool "Support for XRing O1 Fast DFS Clock"
	default n
	help
		Support for clocks run fast dfs logic.
		Say Y if you want to the clock set rate safely.
```

## xring-modules/drivers/coresight/Kconfig
```kconfig
config XRING_CORESIGHT_ETR
	tristate "Support kernel coresight_etr_config"
	depends on XRING_DEBUG
	default m

config XR_CORESIGHT_LINK_AND_SINK_TMC
	tristate "Coresight generic TMC driver"
	depends on CORESIGHT_LINKS_AND_SINKS && XRING_DEBUG
	default m
	help
	  This enables support for the Trace Memory Controller driver.
	  Depending on its configuration the device can act as a link (embedded
	  trace router - ETR) or sink (embedded trace FIFO).  The driver
	  complies with the generic implementation of the component without
	  special enhancement or added features.

	  To compile this driver as a module, choose M here: the
	  module will be called coresight-tmc.
```

## xring-modules/drivers/cpu_sched/Kconfig
```kconfig
menu "CPU & SCHED"

source "../xring-modules/drivers/cpu_sched/amu/Kconfig"
source "../xring-modules/drivers/cpu_sched/avs/Kconfig"
source "../xring-modules/drivers/cpu_sched/ras/Kconfig"
source "../xring-modules/drivers/cpu_sched/walt/Kconfig"
source "../xring-modules/drivers/cpu_sched/dvfs_gov/Kconfig"
source "../xring-modules/drivers/cpu_sched/qis/Kconfig"
source "../xring-modules/drivers/cpu_sched/mpam/Kconfig"
source "../xring-modules/drivers/cpu_sched/touch_boost/Kconfig"
source "../xring-modules/drivers/cpu_sched/gic_routing/Kconfig"

endmenu
```

## xring-modules/drivers/cpu_sched/amu/Kconfig
```kconfig
config XRING_AMU
	tristate "XRing AMU"
	depends on ARM64
	help
	  Provides support for activity monitor unit (AMU) in ARM core.
	  The AMU allows counting some events related to the core, which is
	  intended for system management use. And it is read-only in operation
	  and the configuration is limited to the highest exception level
	  implemented.
```

## xring-modules/drivers/cpu_sched/avs/Kconfig
```kconfig
config XRING_AVS
	tristate "XRing AVS"
	help
	  Provides support for adaptive voltage scaling (AVS). AVS is
	  a power management technique used in computing systems to
	  optimize energy efficiency. This method lower the supply voltage
	  of electronic components based on the quality and does not cause
	  stability issues.
```

## xring-modules/drivers/cpu_sched/dvfs_gov/Kconfig
```kconfig
config XRING_DVFS_GOV
	tristate "Support for XRing DVFS gov Driver"
	depends on XRING_VOTE_MNG
	default n
	help
	  This enables the XRing xsee and memlat driver.
```

## xring-modules/drivers/cpu_sched/gic_routing/Kconfig
```kconfig
config XRING_GIC_ROUTING
	tristate "Support for XRing GIC Routing Driver"
	default n
	help
	  This enables the XRing GIC Routing Driver.
```

## xring-modules/drivers/cpu_sched/mpam/Kconfig
```kconfig
config XRING_MPAM
	tristate "Xring DynamIQ Shared Unit MPAM driver"
	depends on CGROUPS
	depends on CGROUP_SCHED
	default n
	help
	  XRing ARM DynamIQ Shared Unit(DSU)
	  Memory System Resource Partitioning
	  and Monitoring(MPAM) feature.
	  These features include:
		L3 cache partitioning and
		Memory Bandwidth partitioning.
		User can control performance mode and set
		critical tasks.
```

## xring-modules/drivers/cpu_sched/qis/Kconfig
```kconfig
source "../xring-modules/drivers/cpu_sched/qis/qi/Kconfig"
source "../xring-modules/drivers/cpu_sched/qis/qs/Kconfig"
```

## xring-modules/drivers/cpu_sched/qis/qi/Kconfig
```kconfig
# SPDX-License-Identifier: GPL-2.0-only
#
# QoS Inheritance
#

config XRING_QOS_INHERIT
	tristate "Support for XRing QoS Inherit Driver"
	depends on XRING_PERF_ACTUATOR
	default n
	help
	  Enable qos inheritance(QI).
	  With this feature enabled, if the task is
	  blocked by binder request, mutex, rwsem,
	  or futex, and its QOS is critical level, then
	  its QOS will be inherited by binder server or
	  lock owner task.

config XRING_QI_DEBUG
	bool "Support for XRing QoS Inherit Debug"
	depends on XRING_PERF_ACTUATOR
	default n
	help
	  Enable qos inherit debug.
	  With the config enabled, the QI sub features,
	  like binder, mutex, rwsem or futex can be enabled
	  or disabled alone.
```

## xring-modules/drivers/cpu_sched/qis/qs/Kconfig
```kconfig
# SPDX-License-Identifier: GPL-2.0-only
#
# QoS Inheritance and Speedlock
#

config XRING_QOS_SCHED
	tristate "Support for XRing QoS Sched Driver"
	depends on XRING_SCHED_WALT && XRING_SCHED_VIP && XRING_QOS_INHERIT
	default n
	help
	  Enable scheduler based QoS inheritance.
	  With the feature enabled, FIFO schedule policy
	  or VIP schedule will be set to task when the
	  task inherits the critical level QoS from the
	  critical task. With qos speedlock feature enabled,
	  when the task from the critical process try to
	  hold reader rwsem and get blocked, VIP sched
	  schedule will be set to the task until the task
	  releases the rwsem lock.

config XRING_QS_DEBUG
	bool "Support for XRing QoS Sched Debug"
	depends on XRING_QOS_SCHED
	default n
	help
	  Enable qos sched debug.
	  With the config enabled, the sysfs node about
	  surfacelinger prio will be created. Since the
	  prio of FIFO policy depends on surfacelinger's
	  prio, we can change RT sched's prio by writing
	  this node. Meanwhile, the timeout detect mach-
	  anism of speedlock will be enabled. It will
	  print the warning message once the timeout is
	  detected.
```

## xring-modules/drivers/cpu_sched/ras/Kconfig
```kconfig
config XRING_RAS
	tristate "Support kernel ras"
	help
	  Say yes here to support kernel ras

config XRING_RAS_FAULT_INJECT
        bool "Support kernel ras fault inject"
        depends on XRING_RAS
        help
          Say yes here to support kernel ras fault inject
```

## xring-modules/drivers/cpu_sched/touch_boost/Kconfig
```kconfig
config XRING_TOUCH_BOOST
	tristate "Support for XRing Touch Boost Driver"
	default n
	help
	  This enables the XRing Touch Boost Driver.
```

## xring-modules/drivers/cpu_sched/walt/Kconfig
```kconfig
# SPDX-License-Identifier: GPL-2.0
# Copyright (C) 2022-2024, X-Ring technologies Inc., All rights reserved.

menu "WALT based scheduler features"

config XRING_SCHED_WALT
	tristate "Support window based load tracking"
	depends on SMP
	help
	This feature will allow the scheduler to maintain a tunable window
	based set of metrics for tasks and runqueues. These metrics can be
	used to guide task placement as well as task frequency requirements
	for cpufreq governors.

config XRING_CORECTL
	tristate "XRing Core Control Enhancements"
	depends on XRING_SCHED_WALT
	default n
	help
		XRing Enhancements to the Core Control Policy is supposed to
		be faster to respond the tasks, and be reluctant to the
		disturbance. It usually brings up more CPU cores than the
		default policy, which may introduce more energy cost.

		This feature has redefined some of the control parameters.
		Enabling it would require a new setting to have it behave
		as expected.

config XRING_SCHED_VIP
	bool "Support vip scheduler"
	default n
	depends on XRING_SCHED_WALT
	help
	  This feature will add a vip task list in cfs sched class. The
	  high priority vip tasks would preempt the normal tasks and low
	  priority vip tasks. Meanwhile, vip balance is triggered in
	  scheduler tick and other situations to keep high priority vip
	  tasks get a smaller schedule latency.

config XRING_RT_TRACKER
	bool "Related Thread Tracker"
	depends on XRING_PERF_ACTUATOR && XRING_SCHED_WALT
	default n
        help
	  Related Thread Tracker

config XRING_WALT_AMU
	bool "Support walt amu cycle counter"
	default n
	depends on XRING_SCHED_WALT && ARM64_AMU_EXTN
	help
	  This feature will using AMU cycle counter to calculate CPU frequency
	  in WALT.

config XRING_DYN_EM
	bool "Support Dynamic Energy Model"
	default n
	depends on XRING_SCHED_WALT
	help
	  This feature will add multiple energy models for dynamic updated.

config XRING_TASK_PP
	bool "Support task pingpong balance"
	default n
	depends on XRING_SCHED_WALT

config XRING_CPUINFO_TRIM
	bool "Trim cpuinfo to workaround some app compitable problem"
	default n
	depends on XRING_SCHED_WALT
	help
	  This feature will trim some feature print of cpuinfo to keep the output
	  below 4K, some app use 4K buffer to read cpuinfo, and treat buffer full
	  as a failure which causes app abnormal exit.

endmenu
```

## xring-modules/drivers/cpufreq/Kconfig
```kconfig
# CPUfreq Configuration

if CPU_FREQ

config XRING_CPUFREQ_DRV
	tristate "xring cpufreq driver"
	depends on OF && CPU_FREQ && CPU_IDLE
	select PM_OPP
	help
	  This adds a xring cpufreq driver for frequency management.

	  If in doubt, say N.

config XRING_CPUFREQ_GOV
	tristate "xring cpufreq policy governor"
	depends on CPU_FREQ && SMP
	select CPU_FREQ_GOV_ATTR_SET
	select IRQ_WORK
	help
	  This adds a xring cpufreq governor for frequency management.
	  This governor makes decisions based on the utilization data
	  provided by the scheduler. It sets the CPU frequency to be
	  proportional to the utilization/capacity ratio coming from
	  the scheduler.
	  To compile this govnernor as a module, choose M here.

	  If in doubt, say N.

config XRING_CPUTIME_STATS
	tristate "xring cpu time stats driver"
	depends on CPU_FREQ && CPU_IDLE
	select PM_OPP
	help
	  This adds a xring cpu time statistics driver for frequency and idle state.

	  If in doubt, say N.
endif
```

## xring-modules/drivers/cpuidle/Kconfig
```kconfig
# CPU Idle Configuration
menu "xring cpuidle"

config XRING_CPUIDLE
	tristate "xring cpu idle governor"
	depends on CPU_IDLE
	default n
	help
	  This configraution enables all the fundemental functions of
	  XRing cpuidle governor, which enables the monitoring of IPI
	  events and adds the user configuration to change the idle
	  depth of each CPU.

config XRING_CPUIDLE_MENU_GOVERNOR
	tristate "menu governor"
	depends on XRING_CPUIDLE
	default n
	help
	  This enables the XRing improved MENU governor, which has a
	  priority of 50. The governor adds an extra phase after the
	  Menu idle selection, which will further evaluates the prediction
	  by the load of tasks and the prediction accuracy.

endmenu
```

## xring-modules/drivers/ddr/Kconfig
```kconfig
menu "DDR Drivers"

config XRING_DDR
	tristate "Support for XRing DDR Driver"
	help
	  This enables the XRing DDR Driver.

source "../xring-modules/drivers/ddr/ddr_devfreq/Kconfig"
source "../xring-modules/drivers/ddr/ddr_vote_dev/Kconfig"
source "../xring-modules/drivers/ddr/ddr_info/Kconfig"
source "../xring-modules/drivers/ddr/ddr_flux/Kconfig"

endmenu
```

## xring-modules/drivers/ddr/ddr_devfreq/Kconfig
```kconfig
config XRING_DDR_DEVFREQ
	tristate "Support for XRing DDR Devfreq Driver"
	depends on XRING_DDR
	select PM_DEVFREQ
	select DEVFREQ_GOV_POWERSAVE
	select XRING_VOTE_MNG
	help
	  This enables the XRing DDR devfreq driver.
```

## xring-modules/drivers/ddr/ddr_flux/Kconfig
```kconfig
config XRING_DDR_FLUX
	tristate "Support for XRing ddr flux Driver"
	depends on XRING_DDR
	help
	  This enables the XRing ddr flux Driver.
```

## xring-modules/drivers/ddr/ddr_info/Kconfig
```kconfig
config XRING_DDR_INFO
	tristate "Support for XRing DDR Info Driver"
	depends on XRING_DDR
	help
	  This enables the XRing DDR Info Driver.
```

## xring-modules/drivers/ddr/ddr_vote_dev/Kconfig
```kconfig
config XRING_DDR_VOTE_DEV
	tristate "Support for XRing DDR Vote Dev Driver"
	depends on XRING_DDR
	select XRING_VOTE_MNG
	help
	  This enables the XRing DDR devfreq driver.
```
