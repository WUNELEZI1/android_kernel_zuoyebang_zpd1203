## xring-modules/drivers/xsp/Kconfig
```kconfig
# SPDX-License-Identifier: GPL-2.0-only
# Generic Trusted Execution Environment Configuration
config XRING_SP
	tristate "X-ring Secure Partition Execution Environment support"
	depends on HAVE_ARM_SMCCC
	help
	  This implements a ffa interface towards a Secure partition.

if XRING_SP

source "../xring-modules/drivers/xsp/xsp1/Kconfig"

endif
```

## xring-modules/drivers/xsp/xsp1/Kconfig
```kconfig
# SPDX-License-Identifier: GPL-2.0-only
#
# mmu_dump subsystem configuration
#

config XRING_RSP
	tristate "support xring rust secure partition driver"
	default n
	help
	  Say yes here to support xring rust secure partition driver
```

## xring-modules/drivers/zram/Kconfig
```kconfig
# SPDX-License-Identifier: GPL-2.0
config XRING_ZRAM
	tristate "Compressed RAM block device support"
	depends on BLOCK && SYSFS && MMU
	depends on CRYPTO_LZO || CRYPTO_ZSTD || CRYPTO_LZ4 || CRYPTO_LZ4HC || CRYPTO_842 || XRING_ZRAM_LZ4P
	help
	  Creates virtual block devices called /dev/zramX (X = 0, 1, ...).
	  Pages written to these disks are compressed and stored in memory
	  itself. These disks allow very fast I/O and compression provides
	  good amounts of memory savings.

	  It has several use cases, for example: /tmp storage, use as swap
	  disks and maybe many more.

	  See Documentation/admin-guide/blockdev/zram.rst for more information.

choice
	prompt "Default zram compressor"
	default XRING_ZRAM_DEF_COMP_LZORLE
	depends on XRING_ZRAM

config XRING_ZRAM_DEF_COMP_LZORLE
	bool "lzo-rle"
	depends on CRYPTO_LZO

config XRING_ZRAM_DEF_COMP_ZSTD
	bool "zstd"
	depends on CRYPTO_ZSTD

config XRING_ZRAM_DEF_COMP_LZ4
	bool "lz4"
	depends on CRYPTO_LZ4

config XRING_ZRAM_DEF_COMP_LZ4P
	bool "lz4p"
	depends on XRING_ZRAM_LZ4P

config XRING_ZRAM_DEF_COMP_LZO
	bool "lzo"
	depends on CRYPTO_LZO

config XRING_ZRAM_DEF_COMP_LZ4HC
	bool "lz4hc"
	depends on CRYPTO_LZ4HC

config XRING_ZRAM_DEF_COMP_842
	bool "842"
	depends on CRYPTO_842

endchoice

config ZRAM_DEF_COMP
	string
	default "lzo-rle" if XRING_ZRAM_DEF_COMP_LZORLE
	default "zstd" if XRING_ZRAM_DEF_COMP_ZSTD
	default "lz4" if XRING_ZRAM_DEF_COMP_LZ4
	default "lzo" if XRING_ZRAM_DEF_COMP_LZO
	default "lz4hc" if XRING_ZRAM_DEF_COMP_LZ4HC
	default "842" if XRING_ZRAM_DEF_COMP_842

config ZRAM_WRITEBACK
       bool "Write back incompressible or idle page to backing device"
       depends on XRING_ZRAM
       help
	 With incompressible page, there is no memory saving to keep it
	 in memory. Instead, write it out to backing device.
	 For this feature, admin should set up backing device via
	 /sys/block/zramX/backing_dev.

	 With /sys/block/zramX/{idle,writeback}, application could ask
	 idle page's writeback to the backing device to save in memory.

	 See Documentation/admin-guide/blockdev/zram.rst for more information.

config ZRAM_MEMORY_TRACKING
	bool "Track zRam block status"
	depends on XRING_ZRAM && DEBUG_FS
	help
	  With this feature, admin can track the state of allocated blocks
	  of zRAM. Admin could see the information via
	  /sys/kernel/debug/zram/zramX/block_state.

	  See Documentation/admin-guide/blockdev/zram.rst for more information.

config ZRAM_MULTI_COMP
	bool "Enable multiple compression streams"
	depends on XRING_ZRAM
	help
	  This will enable multi-compression streams, so that ZRAM can
	  re-compress pages using a potentially slower but more effective
	  compression algorithm. Note, that IDLE page recompression
	  requires ZRAM_MEMORY_TRACKING.

config XRING_ZRAM_MULTI_PAGES
	bool "Enable multiple pages compression and decompression"
	default y
	depends on XRING_ZSMALLOC_MULTI_PAGES
	help
	  Initially, zram divided large folios into blocks of nr_pages, each sized
	  equal to PAGE_SIZE, for compression. This option fine-tunes zram to
	  improve compression granularity by dividing large folios into larger
	  parts defined by the configuration option ZSMALLOC_MULTI_PAGES_ORDER.

config XRING_ZRAM_LZ4P
	bool "XRING ZRAM LZ4P"
	default n
	help
	  Choose this option to enable zram lz4p.
	  When enable this option, ZRAM enables LZ4P compress and decompress algorithm.

source "../xring-modules/drivers/zram/zsmalloc/Kconfig"
```

## xring-modules/drivers/zram/zsmalloc/Kconfig
```kconfig
# SPDX-License-Identifier: GPL-2.0
config XRING_ZSMALLOC_STAT
	bool "Export zsmalloc statistics"
	depends on XRING_ZRAM
	select DEBUG_FS
	help
	  This option enables code in the zsmalloc to collect various
	  statistics about what's happening in zsmalloc and exports that
	  information to userspace via debugfs.
	  If unsure, say N.

config XRING_ZSMALLOC_CHAIN_SIZE
	int "Maximum number of physical pages per-zspage"
	default 8
	range 4 16
	depends on XRING_ZRAM
	help
	  This option sets the upper limit on the number of physical pages
	  that a zmalloc page (zspage) can consist of. The optimal zspage
	  chain size is calculated for each size class during the
	  initialization of the pool.

	  Changing this option can alter the characteristics of size classes,
	  such as the number of pages per zspage and the number of objects
	  per zspage. This can also result in different configurations of
	  the pool, as zsmalloc merges size classes with similar
	  characteristics.

	  For more information, see zsmalloc documentation.

config XRING_ZSMALLOC_MULTI_PAGES
	bool "support zsmalloc multiple pages"
	default n
	depends on XRING_ZRAM && !CONFIG_HIGHMEM
	help
	  This option configures zsmalloc to support allocations larger than
	  PAGE_SIZE, enabling compression across multiple pages. The size of
	  these multiple pages is determined by the configured
	  XRING_ZSMALLOC_MULTI_PAGES_ORDER.

config XRING_ZSMALLOC_MULTI_PAGES_ORDER
	int "zsmalloc multiple pages order"
	default 4
	range 1 9
	depends on XRING_ZSMALLOC_MULTI_PAGES
	help
	  This option is used to configure zsmalloc to support the compression
	  of multiple pages.
```

## xring-modules/hungtask_demo/Kconfig
```kconfig
config XRING_HUNGTASK_TEST
        tristate "Support for XRing hungtask test"
        depends on XRING_DEBUG
        default m
```

## xring-modules/kdump_demo/Kconfig
```kconfig
config XRING_KDUMP_TEST
        tristate "Support for XRing kdump test"
        depends on XRING_DEBUG
        default m
```

## xring-modules/secure/securelib/Kconfig
```kconfig
menu "Secure Lib"
config SECURE_LIB
	tristate "Support for XRing Secure Library"

endmenu
```

## xring-modules/softlockup_demo/Kconfig
```kconfig
config XRING_SOFTLOCKUP_TEST
        tristate "Support for XRing softlockup test"
        depends on XRING_DEBUG
        default m
```

## xring-modules/xring-hook/Kconfig
```kconfig
menu "Xring Hooks"

source "../xring-modules/xring-hook/printk/Kconfig"

endmenu
```

## xring-modules/xring-hook/printk/Kconfig
```kconfig
config XRING_PRINTK_HOOK
	tristate "support kernel xring printk hook"
	default m
	help
	  Say yes here to support kernel xring printk hook.
	  Currently, only replace the log timestamp with the timestamp IP.
	  But the timestamp will take effort after the ko load.
	  And the buffer code will not compile, which is commented.
```

## xring-modules/xring_ramdisk/Kconfig
```kconfig
config XRING_RAMDISK_TOOL
	tristate "X-Ring ramdisk tool support"
	help
	  This option support xring ramdisk tool to import files to a running system.
```
