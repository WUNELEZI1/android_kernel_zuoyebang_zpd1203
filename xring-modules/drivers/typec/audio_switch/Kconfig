## xring-modules/drivers/typec/audio_switch/Kconfig
```kconfig
# SPDX-License-Identifier: GPL-2.0

config AUDIO_SWITCH_STUB
	tristate "USB Type-C Analog Audio Switch Support"
	depends on I2C
	help
	  Build the driver for USB Type-C analog audio switch.
	  This driver offer mode switch for USB Type-C port.

	  To compile this driver as a builtin driver, choose Y here.
	  To compile this driver as a module, choose M here.
```

## xring-modules/drivers/typec/pd/Kconfig
```kconfig
# SPDX-License-Identifier: GPL-2.0

config TYPEC_PD_CHARGER_STUB
	tristate "USB Type-C PD and Charger Support"
	depends on I2C
	help
	  Build the driver for USB Type-C PD and Charger.
	  This driver offer 5V output on VBus.

	  To compile this driver as a builtin driver, choose Y here.
	  To compile this driver as a module, choose M here.
```

## xring-modules/drivers/uart/Kconfig
```kconfig
menu "Uart Drivers"
	comment "Settings about xring dw-apb-uart module"

config XRING_UART
	tristate "Xring DesignWare APB UART driver"
	help
	  Say M here to build support for the Synopsys DesignWare APB
	  UART block, compatible is xring,dw-apb-uart. This driver is
	  customized based on native kernel source 8250-dw code so that we
	  can fix some bugs already known without upload to upstream and meet
	  future application requirements.

config XRING_UART_NR_UARTS
	int "Maximum number of Xring UART ports"
	depends on XRING_UART
	default "2"
	help
	  Set this to the number of serial ports you want the driver
	  to support.  This includes any ports discovered via ACPI or
	  PCI enumeration and any ports that may be added at run-time
	  via hot-plug, or any ISA multi-port serial cards.

config XRING_UART_DMA
	bool "Xring uart DMA support"
	depends on XRING_UART
	default y
	help
	  Say Y here to build support for the DMA function of the xring uart.
	  The xring uart driver will disable the DMA function if the uart port
	  is used as console. We will try to alloc the DMA handler once the
	  fifosize was set.

config XRING_UART_CONSOLE_SUPPORT
	bool "Xring uart console support"
	depends on XRING_UART
	default y
	help
	  Say Y here to build support for the xring uart console. This console
	  support both synchronous and asynchronous output mode. We can switch
	  the output mode by setting the 'console-fifo-enable = <1>' to the
	  serial device's dts.

config XRING_UART_DEBUG_FS
	bool "Xring uart async tx debug fs"
	depends on XRING_UART_CONSOLE_SUPPORT
	default n
	help
	  Say Y here to build support for the debugging of the asynchronous
	  output mode. We can check the working state of the console output
	  fifo, such as fifo overrun and fifo length. This file node is
	  created in the path debugfs/uart%d_stat.

config XRING_UART_HWLOCK
	bool "Xring uart hwlock support"
	depends on XRING_UART
	default n
	help
	  Say Y here to build support for the hwlock function of the xring uart.

endmenu
```

## xring-modules/drivers/uart_switch/Kconfig
```kconfig
config XRING_UART_SWITCH
	tristate "Support for XRing Uart Switch"
	help
	  Say M here to build support for the Uart Switch driver,
	  compatible is xring,uart-switch. This driver provides
	  debugfs node to allocate a uart channel to specific subsys.
```

## xring-modules/drivers/ufs/xring-ufs/Kconfig
```kconfig
#
# Kernel configuration file for the UFS Host Controller
#
# This code is based on drivers/scsi/ufs/Kconfig
# Copyright (C) 2022-2023, X-Ring technologies Inc., All rights reserved.
#
# Authors:
#	Xianxing Wu <wuxianxing@xiaomi.com>
#	Yujiao Chen <yujiaochen@xiaomi.com>
#	Dongbin Yu <yudongbin@xiaomi.com>
# This program is free software; you can redistribute it and/or
# modify it under the terms of the GNU General Public License
# as published by the Free Software Foundation; either version 2
# of the License, or (at your option) any later version.
# See the COPYING file in the top-level directory or visit
# <http://www.gnu.org/licenses/gpl-2.0.html>
#

config XRING_UFS
	tristate "XRING UFS Controller Driver Core"
	depends on SCSI && SCSI_DMA && SCSI_UFSHCD
	depends on HAS_IOMEM
	depends on SCSI_UFSHCD_PLATFORM
	select PM_DEVFREQ
	select DEVFREQ_GOV_SIMPLE_ONDEMAND
	select NLS
	default n
	help
	  This selects the support for UFS devices in Linux, say Y and make
	  sure that you know the name of your UFS host adapter (the card
	  inside your computer that "speaks" the UFS protocol, also
	  called UFS Host Controller), because you will be asked for it.
	  The module will be called ufshcd.

	  To compile this driver as a module, choose M here and read
	  <file:Documentation/scsi/ufs.rst>.
	  However, do not compile this as a module if your root file system
	  (the one containing the directory /) is located on a UFS device.

config XRING_UFS_RPMB
	bool "XRING ufs rpmb."
	depends on XRING_UFS
	select XRING_RPMB
	select XRING_RPMB_INTF_DEV
	default n
	help
	  Unified RPMB unit interface for UFS. Provides interface for in
	  kernel security controllers to access RPMB unit. Say yes here if
	  you want to access RPMB from user space via character device
	  interface /dev/rpmb%d.

	  If unsure, select N.

config XRING_UFS_CRYPTO
	bool "ufs hc inline crypto opened."
	depends on XRING_UFS && XRING_FBE
	default n
	help
	  This selects whether to run ufs hw crypto. if 'y' is selected,
	  the mask code is executed.If 'n' is selected, the mask code is
	  is not executed.
```

## xring-modules/drivers/usb/Kconfig
```kconfig
# SPDX-License-Identifier: GPL-2.0

menuconfig XRING_USB
	tristate "XRing USB Driver Support"
	depends on OF
	help
	  USB Driver for XRing Platform.
	  This driver act as a glue driver for dwc3.

	  To compile this driver as a builtin driver, choose Y here.
	  To compile this driver as a module, choose M here.

if XRING_USB
config XRING_USB_RESET
	tristate "XRing USB Reset Driver Support"
	depends on OF
	help
	  Build the driver for XRing USB Reset.
	  This driver offer reset controller for XRing USB Module.

	  To compile this driver as a builtin driver, choose Y here.
	  To compile this driver as a module, choose M here.

config XRING_USB_REPEATER
	tristate "XRing USB Repeater Driver Suppor"
	depends on OF
	depends on I2C
	help
	  Build the driver for USB 2.0 Repeater.
	  This driver do hardware config of Repeater.

	  To compile this driver as a builtin driver, choose Y here.
	  To compile this driver as a module, choose M here.

config XRING_USB_PHY
	tristate "XRing USB Phy Driver Support"
	depends on OF
	help
	  Build the driver for XRing USB Phy.
	  This driver do hardware config of USB Phy,
	  and also act as hook of dwc3 driver.

	  To compile this driver as a builtin driver, choose Y here.
	  To compile this driver as a module, choose M here.

config XRING_USB_O1
	bool "Support for XRing O1 Platform"
	help
	  Hardware init/exit for XRing O1 USB Driver.
	  This driver offer hardware poweron, poweroff and
	  initialization config for XRing O1 USB.

	  Say Y if you want to support XRing O1 Platform.

source "../xring-modules/drivers/usb/adsp/Kconfig"
source "../xring-modules/drivers/usb/gadget-function/Kconfig"

endif
```

## xring-modules/drivers/usb/adsp/Kconfig
```kconfig
# SPDX-License-Identifier: GPL-2.0

config XRING_USB_ADSP
	tristate "XRing USB ADSP Driver Support"
  depends on XRING_IPC
	help
	  USB ADSP Driver for XRing Platform.
	  This driver implements usb functions for usb audio offload.
	  It also handles usb ipc messages between ACPU and ADSP.

	  To compile this driver as a builtin driver, choose Y here.
	  To compile this driver as a module, choose M here.
```

## xring-modules/drivers/usb/gadget-function/Kconfig
```kconfig
# SPDX-License-Identifier: GPL-2.0

config XRING_USB_CONFIGFS_RNDIS
	tristate "RNDIS"
	depends on USB_CONFIGFS
	depends on NET
	select USB_U_ETHER
	help
	   Microsoft Windows XP bundles the "Remote NDIS" (RNDIS) protocol,
	   and Microsoft provides redistributable binary RNDIS drivers for
	   older versions of Windows.

	   To make MS-Windows work with this, use Documentation/usb/linux.inf
	   as the "driver info file".  For versions of MS-Windows older than
	   XP, you'll need to download drivers from Microsoft's website; a URL
	   is given in comments found in that info file.
```

## xring-modules/drivers/uwb_sr200/Kconfig
```kconfig
#
# Uwb driver configuration
#

config NXP_UWB_SR200
	tristate "Nxp SR200 UCI protocol driver (SPI) devices"
```

## xring-modules/drivers/video/Kconfig
```kconfig
menu "X-Ring Video Device"

config XRING_VIDEO_VPU
	bool "X-Ring Video VPU Driver Support"
	default y
	help
		This feature supports build xring video drivers.
		Include vdec,venc,memalloc.
		Control the compilation of codecs.
		The default attribute of this configuration is true.

if XRING_VIDEO_VPU

source "../xring-modules/drivers/video/xring_vpu_memmap/Kconfig"
source "../xring-modules/drivers/video/vdec/Kconfig"
source "../xring-modules/drivers/video/venc/Kconfig"

endif

endmenu
```

## xring-modules/drivers/video/vdec/Kconfig
```kconfig
config XRING_VIDEO_VDEC
	tristate "VDEC enable"
	default m
	help
	  Choose this option if you have a XRing VPU.
	  If M is selected the module will be called hantrodec.
```

## xring-modules/drivers/video/venc/Kconfig
```kconfig
config XRING_VIDEO_VENC
	tristate "VENC enable"
	default m
	help
	  Choose this option if you have a XRing VPU.
	  If M is selected the module will be called hantro enc.
```

## xring-modules/drivers/video/xring_vpu_memmap/Kconfig
```kconfig
config XRING_VIDEO_MEMMAP
	tristate "MEMMAP enable"
	default m
	help
	  Choose this option if you have a XRing VPU.
	  If M is selected the module will be called memmap.
```

## xring-modules/drivers/virtio_rpmsg/Kconfig
```kconfig
menu "X-Ring Virtio Rpmsg drivers"

config XRING_RPMSG_NS
	tristate "RPMSG name service announcement"
	depends on RPMSG
	help
	  Say Y here to enable the support of the name service announcement
	  channel that probes the associated RPMsg device on remote endpoint
	  service announcement.

config XRING_RPMSG_VIRTIO
	tristate "Virtio RPMSG bus driver"
	depends on HAS_DMA
	depends on RPMSG
	depends on XRING_RPMSG_NS
	depends on VIRTIO
	help
		Choose this option to enable virtio rpmsg bus driver.

endmenu
```

## xring-modules/drivers/vote_mng/Kconfig
```kconfig
config XRING_VOTE_MNG
	tristate "support kernel vote mng"
	help
	  Say yes here to support kernel vote management
```

## xring-modules/drivers/wdt/Kconfig
```kconfig
config XRING_WDT
	tristate "Support for XRing wdt"

config XRING_WDT_DISABLE
	bool "Disable XRing wdt"
	default n
```

## xring-modules/drivers/xr_coul/Kconfig
```kconfig
# SPDX-License-Identifier: GPL-2.0-only
menuconfig XRING_COUL
	tristate "Xring's coul support"
	help
	  If you want XRING_COUL support, you should say Y here.Xring coul
	  driver which use the periodic sampling of the battery voltage
	  and current to determine the battery state-of-charge (SOC)
	  and supports other battery management features.

menuconfig XRING_COUL_PSY
	tristate "Xring's coul power supply support"
	help
	  If you want XRING_COUL_PSY support, you should say Y here.Xring coul
	  power supply driver which get battery infomation from coul driver
	  and transfer battery information to healthd or ohter driver
	  by power supply subsystem.

if XRING_COUL
config XRING_COUL_XP2210
	tristate  "Xring coul device driver support"
	help
	  If you want XRING_COUL_DEV support, you should say Y here.
	  The XRING COUL XP2210 driver is used to initializing
	  the Coulomb Counter Hardware and get params form the
	  Coulomb Counter Hardware.

config XRING_COUL_INTERFACE
	tristate "Xring xoul coul interface support"
	help
	  If you want XRING_COUL_INTERFACE support, you should say Y here.
	  The XRING COUL INTERFACE driver is used to provides an interface
	  or other drivers to obtain coulomb counter information.
	  It can support dual fuel gauge parameter fitting function.

config XRING_BATTERY_PROFILE
	tristate "Xring xoul battery profile support"
	help
	  If you want XRING_BATTERY_PROFILE support, you should say Y here.
	  The XRING BATTER PROFILE drive is used to get battery curve from
	  battery profile dts and provide battery parameters to the
	  coulomb counter core driver for use.

endif # XRING_COUL
```

## xring-modules/drivers/xr_kdump/Kconfig
```kconfig
config XRING_KDUMP
	tristate "Support xring kernel dump"
	depends on XRING_DFX_SWITCH
	default m
	help
	  Provide xring kdump support for the kernel.
	  Say yes here to support xring kernel dump.

	  This option allows you to enable xring kdump module.
	  If unsure, say N.
```

## xring-modules/drivers/xr_minidump/Kconfig
```kconfig
config XRING_MINIDUMP
	tristate "Support xring minidump"
	default m
	help
	  Provide xring minidump support for the kernel.
	  Say yes here to support xring minidump.

	  This option allows you to enable xring minidump module.
	  If unsure, say N.
```

## xring-modules/drivers/xrcrypto/Kconfig
```kconfig
config XRING_CRYPTO
        tristate "support kernel hardware crypto"
        help
          Say yes here to support security feature test
```

## xring-modules/drivers/xring_w1/Kconfig
```kconfig
# SPDX-License-Identifier: GPL-2.0-only
menuconfig XRING_W1
	tristate "Dallas's 1-wire support"
	depends on HAS_IOMEM
	help
	  XRING_W1
	  Dallas' 1-wire bus is useful to connect slow 1-pin devices
	  such as iButtons and thermal sensors.

	  If you want W1 support, you should say Y here.

	  This W1 support can also be built as a module.  If so, the module
	  will be called wire.

if XRING_W1

config XRING_W1_CON
	depends on CONNECTOR
	bool "Userspace communication over connector"
	help
	  This allows to communicate with userspace using connector. For more
	  information see <file:Documentation/driver-api/connector.rst>.
	  There are three types of messages between w1 core and userspace:
	  1. Events. They are generated each time new master or slave device found
		either due to automatic or requested search.
	  2. Userspace commands. Includes read/write and search/alarm search commands.
	  3. Replies to userspace commands.

source "../xring-modules/drivers/xring_w1/masters/Kconfig"
source "../xring-modules/drivers/xring_w1/slaves/Kconfig"

endif # XRING_W1
```

## xring-modules/drivers/xring_w1/masters/Kconfig
```kconfig
# SPDX-License-Identifier: GPL-2.0-only
#
# 1-wire bus master configuration
#

menu "1-wire Bus Masters"


config XRING_W1_MASTER
	tristate "XRING 1-wire busmaster"
	help
	  Say Y here to enable the XRING 1-wire driver.

endmenu
```

## xring-modules/drivers/xring_w1/slaves/Kconfig
```kconfig
# SPDX-License-Identifier: GPL-2.0-only
#
# 1-wire slaves configuration
#

menu "1-wire Slaves"

config XRING_W1_SLAVE_SLG
	tristate "SLG 1-Wire Battery ID"
	select CRC16
	help
	  If you enable this you will have the SLG Battery ID
	  chip support.

	  Say Y here if you want to use a 1-wire
	  SLG Battery ID chip.

	  If you are unsure, say N.

endmenu
```

## xring-modules/drivers/xrse/Kconfig
```kconfig
menu "Xring XRSE Module Driver"

config XRING_XRSE
	tristate "support xrse driver in kernel side"
	default n
	help
	  support xrse driver in kernel side.

config XRING_XRSE_SECBOOT
	bool "support xrse secboot in kernel side"
	default n
	depends on XRING_XRSE
	help
	  support xrse secboot modules.

config XRING_XRSE_DFX
	bool "support xrse dfx in kernel side"
	default n
	depends on XRING_XRSE
	help
	  support xrse dfx modules.

config XRING_XRSE_PWRMNG
	bool "support xrse power management in kernel side"
	default n
	depends on XRING_XRSE
	help
	  support xrse power management modules.

config XRING_XRSE_RIP
	bool "support xrse rip driver"
	default n
	depends on XRING_XRSE
	help
	  support xrse rip in kernel

config XRING_XRSE_BOOT_RETRY_RECORD
	bool "Enable xrse retry record"
	depends on MIEV
	default n
	help
	  Enable xrse retry record

endmenu
```
