// SPDX-License-Identifier: GPL-2.0+
/*
 * DSI panel device tree for fpga testing
 *
 * (C) Copyright 2023 - 2024, X-Ring, Inc.
 */

&{/} {
	dsi_panel_n16_dsc_vid: dsi_panel_n16_dsc_vid {
		status = "disabled";
		dsi-panel-name = "xiaomi n16 42 0b video mode dsc panel";
		dsi-panel-id = <0x6>;
		dsi-panel-type = "dsi_video_mode";
		dsi-burst-mode = "burst_mode";
		dsi-panel-width = <1220>;
		dsi-panel-height = <2712>;
		dsi-panel-backlight-setting-type = "cmd";
		dsi-panel-brightness-max-level = <2047>;
		dsi-panel-brightness-min-level = <20>;
		dsi-panel-brightness-init-level = <2167>;
		dsi-panel-phy-type = "dphy";
		dsi-panel-clk-type = "non_continuous";
		dsi-panel-lane-number = <4>;
		dsi-panel-lane-rate = <1064269440>;
		dsi-panel-pixel-clock = <20467000>;
		dsi-panel-bpp = <30>;
		dsi-panel-virtual-channel = <0>;
		//dsi-panel-bta-enable;
		//dsi-panel-eotp-enable;
		// dsi-panel-esd-check-enable;
		dsi-panel-hdr-enabled;
		dsi-panel-peak-brightness = <9000000>;
		dsi-panel-blackness-level = <50>;
		dsi-panel-physical-width-dimension = <695>;
		dsi-panel-physical-height-dimension = <1545>;
		dsi-panel-physical-type = "ltps";
		dsi-panel-port-mask = /bits/ 8 <0x2>; // DSI-1: 0010
		dsi-panel-boot-up-profile = <1>; //profile_1
		dsi-panel-lowpower-ctrl = <0xd>;
		dsi-panel-frame-power-mask = <0x0>;
		dsi-panel-frame-power-max-refresh-rate = <0>;
		dsi-panel-idle-policy = <0x0>;
		dsi-panel-dsc-compression-mode = "dsc";
		dsi-panel-dsc-version = <0x12>;
		dsi-panel-dsc-scr-version = <0>;
		dsi-panel-dsc-pic-width = <1220>;
		dsi-panel-dsc-pic-height = <2712>;
		dsi-panel-dsc-slice-height = <12>;
		dsi-panel-dsc-slice-width = <610>;
		dsi-panel-dsc-bpc = /bits/ 8 <10>;
		dsi-panel-dsc-bpp = /bits/ 8 <8>;
		dsi-panel-dsc-pps-table = [
				12 00 00 AB 30 80 0A 98 04 C4 00 0C 02 62 02 62
				02 00 02 32 00 20 01 31 00 08 00 0C 08 BB 07 7B
				18 00 10 F0 07 10 20 00 06 0F 0F 33 0E 1C 2A 38
				46 54 62 69 70 77 79 7B 7D 7E 02 02 22 00 2A 40
				2A BE 3A FC 3A FA 3A F8 3B 38 3B 78 3B B6 4B B6
				4B F4 4B F4 6C 34 84 74 00 00 00 00 00 00 00 00
				00 00 00 00 00 00 00 00 00 00 00 00 00 00 00 00
				00 00 00 00 00 00 00 00 00 00 00 00 00 00 00 00
		];
		dsi-panel-reset-after-lp11;
		dsi-display-timings {
			default_index_00 {
				dsi-panel-frame-rate = <120>;
				dsi-panel-vrr-type = <2>;
				dsi-panel-supported-fps-list = <120 90 60 30>;
				dsi-panel-h-front-porch = <16>;
				dsi-panel-h-back-porch = <12>;
				dsi-panel-h-pulse-width = <12>;
				dsi-panel-h-sync-skew = <0>;
				dsi-panel-v-back-porch = <16>;
				dsi-panel-v-front-porch = <52>;
				dsi-panel-v-pulse-width = <4>;
				dsi-panel-on-command = [
					39 00 00 40 00 00 06 F0 55 AA 52 08 00
					39 00 00 40 00 00 02 6F 03
					39 00 00 40 00 00 02 C0 21
					//FPR_MODE = 0, FPR_ELVSS_EN = 1, FPR_ELVSS_DELAY = 1
					39 00 00 40 00 00 02 DF 09
					//FPR_EM_SWITCH_EN = 1, FPR_ALPHA_LUT_EN = 1
					39 00 00 40 00 00 02 6F 01
					39 00 00 40 00 00 02 DF 40
					//FPR_GMA_SEL[3:0] = 0, FPR_DGMA_SET_EN = 1, FPR_DGMA_SET_SEL[3:0] = 11
					39 00 00 40 00 00 02 6F 31
					39 00 00 40 00 00 03 DF 00 1A
					//FPR_ELVSS[7:0] = 47
					39 00 00 40 00 00 02 6F 34
					39 00 00 40 00 00 02 DF 23
					39 00 00 40 00 00 02 6F 2D
					39 00 00 40 00 00 06 C0 00 32 00 04 50
					39 00 00 40 00 00 02 6F 01
					39 00 00 40 00 00 02 C7 01
					39 00 00 40 00 00 06 F0 55 AA 52 08 01
					//FPR_VINITP1_EN = 0, FPR_VINITN1_EN = 1, FPR_VINITN2_EN = 0, FPR_VINITN3_EN = 0
					39 00 00 40 00 00 02 6F 2A
					39 00 00 40 00 00 02 B9 10
					//FPR_VINITN1 = (1A=-1.3V)
					39 00 00 40 00 00 02 6F 0C
					39 00 00 00 00 00 02 B9 1A
					39 00 00 40 00 00 02 6F 05
					39 00 00 40 00 00 03 E3 00 00
					39 00 00 40 00 00 02 6F 0A
					39 00 00 00 00 00 05 E3 00 00 00 00
					39 00 00 40 00 00 06 F0 55 AA 52 08 08
					39 00 00 40 00 00 02 6F CE
					39 00 00 40 00 00 02 BC 01
					39 00 00 40 00 00 02 6F CF
					39 00 00 00 00 00 09 BC 01 11 00 B6 01 11 00 44
					39 00 00 40 00 00 02 BE 03
					39 00 00 40 00 00 02 6F 0C
					39 00 00 00 00 00 09 E9 1D 36 0F D6 1C 51 0F AB
					39 00 00 00 00 00 06 88 81 02 61 09 85
					39 00 00 40 00 00 05 FF AA 55 A5 80
					39 00 00 40 00 00 02 6F 2A
					39 00 00 40 00 00 02 F4 08
					39 00 00 40 00 00 02 6F 46
					39 00 00 40 00 00 03 F4 07 09
					39 00 00 40 00 00 02 6F 4A
					39 00 00 40 00 00 03 F4 08 0A
					39 00 00 40 00 00 02 6F 56
					39 00 00 00 00 00 03 F4 44 44
					39 00 00 40 00 00 05 FF AA 55 A5 81
					39 00 00 40 00 00 02 6F 3C
					39 00 00 40 00 00 02 F5 84
					39 00 00 00 00 00 02 17 03
					39 00 00 40 00 00 02 71 00
					39 00 00 00 00 00 09 8D 00 00 04 C3 00 00 0A 97
					39 00 00 40 00 00 05 2A 00 00 04 C3
					39 00 00 40 00 00 05 2B 00 00 0A 97
					39 00 00 40 00 00 03 90 03 43
					39 00 00 40 00 00 13 91 AB A8 00 0C C2 00 02 32 01 31 00 08 08 BB 07 7B 10 F0
					39 00 00 40 00 00 0D 3B 00 0B 00 2D 00 0B 03 CD 00 0B 0A FD
					39 00 00 00 00 00 02 6F 10
					39 00 00 40 00 00 05 3B 00 0B 00 2D
					39 00 00 40 00 00 02 35 00
					39 00 00 40 00 00 02 6F 04
					39 00 00 40 00 00 03 51 00 00
					39 00 00 40 00 00 02 53 20
					39 00 00 40 00 00 02 57 00
					39 00 00 40 00 00 02 2F 00
					39 00 00 40 00 00 02 26 00
					39 00 00 00 00 00 03 5F 04 40
					/*ESD*/
					39 00 00 40 00 00 06 F0 55 AA 52 08 00
					39 00 00 40 00 00 03 BE 47 45
					39 00 00 40 00 00 02 6F 05
					39 00 00 00 00 00 02 BE 28
					39 00 00 40 00 00 02 6F 19
					39 00 00 40 00 00 05 BE 10 91 00 AB
					39 00 00 40 00 00 02 6F 0D
					39 00 00 00 00 00 02 D8 02
					/*SPR for P1.1*/
					39 00 00 00 00 00 06 F0 55 AA 52 08 07
					//SPR setting
					39 00 00 00 00 00 07 B0 8C C0 78 70 00 00
					39 00 00 00 00 00 07 B1 1C 0C 00 0C 1C 00
					//Index 0
					39 00 00 00 00 00 0A B2 28 28 28 28 28 28 28 28 28
					39 00 00 00 00 00 02 6F 36
					39 00 00 00 00 00 13 B2 32 32 32 32 32 32 32 32 32 0C 0C 0C 0C 0C 0C 0C 0C 0C
					//Index 1
					39 00 00 00 00 00 02 6F 09
					39 00 00 00 00 00 0A B2 28 28 28 28 28 28 28 28 28
					39 00 00 00 00 00 02 6F 48
					39 00 00 00 00 00 13 B2 32 32 32 32 32 32 32 32 32 0C 0C 0C 0C 0C 0C 0C 0C 0C
					//Index 3
					39 00 00 00 00 00 02 6F 1B
					39 00 00 00 00 00 0A B2 28 28 28 28 28 28 28 28 28
					39 00 00 00 00 00 02 6F 6C
					39 00 00 00 00 00 13 B2 32 32 32 32 32 32 32 32 32 0C 0C 0C 0C 0C 0C 0C 0C 0C
					//Index 4
					39 00 00 00 00 00 02 6F 24
					39 00 00 00 00 00 0A B2 28 28 28 28 28 28 28 28 28
					39 00 00 00 00 00 02 6F 7E
					39 00 00 00 00 00 13 B2 32 32 32 32 32 32 32 32 32 0C 0C 0C 0C 0C 0C 0C 0C 0C
					39 00 00 00 00 00 02 B3 6C
					/*video trim*/
					39 00 00 40 00 00 06 F0 55 AA 52 08 01
					39 00 00 40 00 00 02 EA 91
					39 00 00 40 00 00 02 6F 08
					39 00 00 40 00 00 02 EA 48
					39 00 00 40 00 00 02 6F 0B
					39 00 00 40 00 00 02 EA 91
					39 00 00 40 00 00 02 6F 13
					39 00 00 40 00 00 02 EA 72
					39 00 00 40 00 00 02 6F 04
					39 00 00 40 00 00 02 C3 0A
					39 00 00 40 00 00 02 6F 09
					39 00 00 00 00 00 02 C3 0A
					/*LVDT*/
					39 00 00 40 00 00 06 F0 55 AA 52 08 01
					39 00 00 40 00 00 02 6F 03
					39 00 00 00 00 00 02 C7 C7
					/*VTE&HTE*/
					39 00 00 40 00 00 06 F0 55 AA 52 08 00
					39 00 00 40 00 00 02 6F 02
					39 00 00 40 00 00 03 BE 4C 4B
					39 00 00 40 00 00 06 F0 55 AA 52 08 01
					39 00 00 40 00 00 04 D1 07 04 04
					39 00 00 40 00 00 02 6F 08
					39 00 00 40 00 00 02 D1 01
					39 00 00 40 00 00 02 6F 0B
					39 00 00 00 00 00 02 D1 01
					/*Delay 120ms*/
					39 00 00 00 78 00 02 11 00
					/* Display On */
					39 00 00 00 00 00 02 29 00
					/*120hz gain*/
					39 00 00 40 00 00 06 F0 55 AA 52 08 04
					39 00 00 40 00 00 02 CB 66
					//dbv0 8h
					39 00 00 40 00 00 06 DD 05 08 1F 3E 9B
					//dbv1 62h
					39 00 00 40 00 00 02 6F 05
					39 00 00 40 00 00 06 DD 05 08 1F 3E 9B
					//dbv2 147h
					39 00 00 40 00 00 02 6F 0A
					39 00 00 40 00 00 06 DD 05 08 1F 3E 9B
					//dbv3 4A3H
					39 00 00 40 00 00 02 6F 0F
					39 00 00 40 00 00 06 DD 05 08 1F 3E 9B
					//dbv4 7FF
					39 00 00 40 00 00 02 6F 14
					39 00 00 40 00 00 06 DD 05 08 1F 3E 9B
					//dbv5 FFF
					39 00 00 40 00 00 02 6F 19
					39 00 00 00 00 00 06 DD 05 08 1F 3E 9B
					39 00 00 40 00 00 02 6F 5A
					39 00 00 40 00 00 07 D2 10 10 10 10 10 14
					39 00 00 40 00 00 02 6F 60
					39 00 00 40 00 00 07 D2 10 10 10 10 10 0C
					39 00 00 40 00 00 02 6F 66
					39 00 00 40 00 00 07 D2 12 12 12 12 12 0C
					39 00 00 40 00 00 02 6F 6C
					39 00 00 40 00 00 07 D2 12 12 12 12 12 0A
					39 00 00 40 00 00 02 6F 72
					39 00 00 00 00 00 07 D2 12 12 12 12 12 08
					39 00 00 40 00 00 02 6F 78
					39 00 00 40 00 00 07 D2 28 28 28 28 28 14
					39 00 00 40 00 00 02 6F 7E
					39 00 00 40 00 00 07 D2 1A 1A 1A 1A 1A 10
					39 00 00 40 00 00 02 6F 84
					39 00 00 40 00 00 07 D2 1A 1A 1A 1A 1A 10
					39 00 00 40 00 00 02 6F 8A
					39 00 00 40 00 00 07 D2 1A 1A 1A 1A 1A 10
					39 00 00 40 00 00 02 6F 90
					39 00 00 00 00 00 07 D2 1A 1A 1A 1A 1A 08
					39 00 00 40 00 00 02 6F 96
					39 00 00 40 00 00 07 D2 14 14 14 14 14 10
					39 00 00 40 00 00 02 6F 9C
					39 00 00 40 00 00 07 D2 10 10 10 10 10 08
					39 00 00 40 00 00 02 6F A2
					39 00 00 40 00 00 07 D2 0D 0D 0D 0D 0D 08
					39 00 00 40 00 00 02 6F A8
					39 00 00 40 00 00 07 D2 0D 0D 0D 0D 0D 08
					39 00 00 40 00 00 02 6F AE
					39 00 00 00 00 00 07 D2 0B 0B 0B 0B 0B 08
					/*3D LUT*/
					39 00 00 00 00 00 06 F0 55 AA 52 08 00
					39 00 00 00 00 00 02 E6 80
					39 00 00 00 00 00 02 6F EA
					39 00 00 00 00 00 07 E8 10 10 20 00 00 00
					39 00 00 00 00 00 02 E6 81
					39 00 00 00 00 00 02 6F EA
					39 00 00 00 00 00 07 E8 10 10 20 00 00 00
					39 00 00 00 00 00 02 E6 82
					39 00 00 00 00 00 02 6F EA
					39 00 00 00 00 00 07 E8 10 10 20 00 00 00
					39 00 00 00 00 00 02 E6 83
					39 00 00 00 00 00 02 6F EA
					39 00 00 00 00 00 07 E8 10 10 20 00 00 00
					39 00 00 00 00 00 02 E6 84
					39 00 00 00 00 00 02 6F EA
					39 00 00 00 00 00 07 E8 10 10 20 00 00 00
					39 00 00 00 00 00 02 E6 85
					39 00 00 00 00 00 02 6F EA
					39 00 00 00 00 00 07 E8 10 10 20 00 00 00
					39 00 00 00 00 00 02 E6 86
					39 00 00 00 00 00 02 6F EA
					39 00 00 00 00 00 07 E8 10 10 20 00 00 00
					39 00 00 00 00 00 02 E6 87
					39 00 00 00 00 00 02 6F EA
					39 00 00 00 00 00 07 E8 10 10 20 00 00 00
					39 00 00 00 00 00 02 E6 88
					39 00 00 00 00 00 02 6F EA
					39 00 00 00 00 00 07 E8 10 10 20 00 00 00
					39 00 00 00 00 00 02 E6 00
				];
				dsi-panel-on-command-state = "dsi_lp_mode";

				dsi-panel-off-command = [
					39 00 00 00 00 00 02 28 00
					39 00 00 00 78 00 02 10 00
				];
				dsi-panel-off-command-state = "dsi_lp_mode";

				dsi-panel-backlight-command = [
					39 00 00 00 00 00 03 51 03 FF
				];
				dsi-panel-backlight-command-update = <0x51 0 2>;
				dsi-panel-backlight-command-state = "dsi_lp_mode";
			};
		};
	};
};
