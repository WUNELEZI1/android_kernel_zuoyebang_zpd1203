// SPDX-License-Identifier: GPL-2.0+
/*
 * DSI panel device tree for fpga testing
 *
 * (C) Copyright 2023 - 2024, X-Ring, Inc.
 */

&{/} {
	fake_dsi_panel: fake_dsi_panel {
		status = "disabled";
		dsi-panel-name = "fake_dsi_panel";
		dsi-panel-id = <0x0>;
		dsi-panel-type = "dsi_video_mode";
		dsi-burst-mode = "non_burst_sync_pulses";
		dsi-panel-width = <1440>;
		dsi-panel-height = <3200>;
		dsi-panel-backlight-setting-type = "cmd";
		dsi-panel-brightness-max-level = <2047>;
		dsi-panel-brightness-min-level = <20>;
		dsi-panel-brightness-init-level = <2047>;
		dsi-panel-phy-type = "dphy";
		dsi-panel-clk-type = "non_continuous";
		dsi-panel-lane-number = <4>;
		dsi-panel-lane-rate = <650002766>; // 650.002766MHz
		dsi-panel-pixel-clock = <13542000>; //13.542MHz
		dsi-panel-bpp = <24>;
		dsi-panel-virtual-channel = <0>;
		// dsi-panel-bta-enable;
		// dsi-panel-eotp-enable;
		dsi-panel-esd-check-enable;
		dsi-panel-hdr-enabled;
		dsi-panel-peak-brightness = <4200000>;
		dsi-panel-blackness-level = <3230>;
		dsi-panel-physical-width-dimension = <701>;
		dsi-panel-physical-height-dimension = <1558>;
		dsi-panel-physical-type = "ltpo";
		dsi-panel-te-sel = /bits/ 8 <0x0>;
		dsi-panel-port-mask = /bits/ 8 <0x1>; // DSI-0: 0001
		dsi-panel-boot-up-profile = <1>; //profile_1
		dsi-panel-lowpower-ctrl = <0x0>; //disable all low power features
		dsi-panel-frame-power-mask = <0x0>;
		dsi-panel-frame-power-max-refresh-rate = <0>;
		dsi-panel-idle-policy = <0x0>;
		dsi-panel-dsc-compression-mode = "dsc";
		dsi-panel-dsc-version = <0x12>;
		dsi-panel-dsc-scr-version = <0>;
		dsi-panel-dsc-pic-height = <3200>;
		dsi-panel-dsc-pic-width = <1440>;
		dsi-panel-dsc-slice-height = <20>;
		dsi-panel-dsc-slice-width = <720>;
		dsi-panel-dsc-bpc = /bits/ 8 <10>;
		dsi-panel-dsc-bpp = /bits/ 8 <8>;
		dsi-display-timings {
			default_index_00 {
				dsi-panel-frame-rate = <60>;
				dsi-panel-vrr-type = <0>;
				dsi-panel-width = <1440>;
				dsi-panel-height = <3200>;
				dsi-panel-h-front-porch = <16>;
				dsi-panel-h-back-porch = <16>;
				dsi-panel-h-pulse-width = <16>;
				dsi-panel-h-sync-skew = <0>;
				dsi-panel-v-back-porch = <24>;
				dsi-panel-v-front-porch = <64>;
				dsi-panel-v-pulse-width = <4>;

				dsi-panel-timing-switch-command = [
					/*120HZ*/
					39 00 00 40 00 00 02 26 03
					39 00 00 40 00 00 02 2F 00
					/*60HZ*/
					39 00 00 40 00 00 02 2F 30
					39 00 00 40 00 00 06 F0 55 AA 52 08 00
					39 00 00 40 00 00 02 6F 1C
					39 00 00 40 00 00 0A BA 91 01 01 00 01 01 01 00 00
					39 00 00 40 00 00 02 BC 20
					39 00 00 00 00 00 02 2C 00
				];
				dsi-panel-timing-switch-command-update = <0x26 0 1>;
				dsi-panel-timing-switch-command-state = "dsi_hs_mode";

				dsi-panel-on-command = [
					#include "dsi_panel_m1_42_02_0a_dsc_cmd_dsi_on_common.dtsi"
					/*120HZ*/
					39 00 00 40 00 00 02 26 03
					39 00 00 40 00 00 02 2F 00
					/*60HZ*/
					39 00 00 40 00 00 02 2F 30
					39 00 00 40 00 00 06 F0 55 AA 52 08 00
					39 00 00 40 00 00 02 6F 1C
					39 00 00 40 00 00 0A BA 91 01 01 00 01 01 01 00 00
					39 00 00 40 00 00 02 BC 00
					/* Set TE width */
					39 00 00 40 00 00 08 BA 00 50 00 14 0C EC 10
					39 00 00 40 00 00 02 2F 00

					39 00 00 40 00 00 02 2C 00
					/* Sleep Out */
					05 00 00 00 78 00 01 11
					/*black mask off*/
					39 00 00 00 00 00 02 9B 00
					39 00 00 40 00 00 06 F0 55 AA 52 08 02
					39 00 00 40 00 00 02 CC 10
					/* Display On */
					05 00 00 00 00 00 01 29
				];
				dsi-panel-on-command-state = "dsi_hs_mode";

				dsi-panel-off-command = [
					/*AOD Off*/
					39 00 00 40 00 00 02 65 00
					39 00 00 40 00 00 02 38 00
					39 00 00 00 32 00 02 2C 00
					/*Power off*/
					05 00 00 00 00 00 01 28
					05 00 00 00 78 00 01 10
				];
				dsi-panel-off-command-state = "dsi_hs_mode";

				dsi-panel-backlight-command = [
					39 00 00 00 00 00 03 51 07 FF
				];
				dsi-panel-backlight-command-update = <0x51 0 2>;
				dsi-panel-backlight-command-state = "dsi_hs_mode";
			};
		};
	};
};
