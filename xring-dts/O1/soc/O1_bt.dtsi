// SPDX-License-Identifier: GPL-2.0+
/*
 * (C) Copyright 2023 - 2023, X-Ring, Inc.
 *
 */

/ {
    bt: bt {
        compatible = "mediatek,bt";
        pinctrl-names = "uart3_4_txd_init",
			"uart3_4_rxd_init",
			"uart3_4_cts_init",
			"uart3_4_rts_init",
			"uart3_4_txd_default",
			"uart3_4_rxd_default",
			"uart3_4_cts_default",
			"uart3_4_rts_default",
			"bt_rst_on",
			"bt_rst_off",
			"bt-find-my-phone-high",
			"bt-find-my-phone-low";
    };
};
