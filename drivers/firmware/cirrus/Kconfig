## drivers/input/touchscreen/td4160_spi/Kconfig
```kconfig
config TOUCHSCREEN_OMNIVISION_TCM_SPI
	tristate "Omnivision TCM enable module"
	help
		Say Y here if you enable Omnivision TCM feature.
		If unsure, say N.
		To compile this driver as a module, choose M here: the
		module will be called omnivision_tcm_core.

config TOUCHSCREEN_OMNIVISION_TCM_I2C
	tristate "Omnivision TCM enable module"
	help
		Say Y here if you enable Omnivision TCM feature.
		If unsure, say N.
		To compile this driver as a module, choose M here: the
		module will be called omnivision_tcm_core.
```

## drivers/input/touchscreen/xiaomi_tp/Kconfig
```kconfig
config TOUCHSCREEN_COMMON
	tristate "Xiaomi Touch Feature"
	help
		Say Y here if you enable xiaomi touch feature.
		If unsure, say N.
```

## drivers/ir-spi/Kconfig
```kconfig
config IR_SPI
	tristate "SPI connected IR LED"
	depends on SPI && of
	help
	  Say Y if you want to use an IR LED connected through SPI bus.
	  To compile this driver as a module, choose M here: the module will be
	  called ir-spi
```

## drivers/misc/mediatek/board_id/Kconfig
```kconfig
config BOARD_ID_SUPPORT
	tristate "Xiaomi Board ID Support"
	default n
	help
	  Say 'm' here to support Board ID support
```

## drivers/misc/mediatek/bootinfo/Kconfig
```kconfig
config BOOT_INFO_SUPPORT
	tristate "Xiaomi Boot Info Support"
	default n
	help
	  Say 'm' here to support Boot Info support
```

## drivers/power/supply/driver/battery_secret/Kconfig
```kconfig
config BATTERY_SECRET_ACL16_SLG2
	tristate "acl16_slg2 driver"
	prompt "Support slg as encryption IC."
	default n
	help
		It needs a onewire physical controller to work.

config BATTERY_SECRET_DS28E30
	tristate "ds28e30 driver"
	prompt "Support ds28e16 as encryption IC."
	default n
	help
		It needs a onewire physical controller to work.


config LC_BATTERY_SECRET
	tristate "lc battery secret ic drivers"
	prompt "Support all ic as encryption IC."
	default n
	help
		It needs a onewire physical controller to work.
```

## drivers/power/supply/middleware/battery_secret_manager/Kconfig
```kconfig
config BATTERY_SECRET_MANAGER
    tristate "support longcheer battery secret manager module"
    default n
    help
        Say 'm' here to support test module
```

## drivers/power/supply/middleware/lc_logfs_class/Kconfig
```kconfig
config LC_LOGFS_CLASS
    tristate "lc logfs module"
    default n
    help
        Say 'm' here to support lc logfs module
```

## drivers/powerinsight/Kconfig
```kconfig
source "$(KCONFIG_EXT_PREFIX)drivers/powerinsight/gpu_stats/Kconfig"
source "$(KCONFIG_EXT_PREFIX)drivers/powerinsight/gpu_freq_stats/Kconfig"
source "$(KCONFIG_EXT_PREFIX)drivers/powerinsight/common/Kconfig"
```

## drivers/powerinsight/common/Kconfig
```kconfig
config POWERINSIGHT
	tristate "Power Insight"
	default n
	help
	  This driver provides PowerInsight feature

config POWERINSIGHT_TASK_CPU_POWER
	tristate "powerinsight Task CPU Power"
	depends on POWERINSIGHT && (CPU_FREQ_POWER_STAT || ARCH_MSM)
	help
	  Get task cpu power
```

## drivers/powerinsight/gpu_freq_stats/Kconfig
```kconfig
config POWERINSIGHT_GPU_FREQ_STATS
	tristate "Power Insight GPU Freq"
	default n
	depends on POWERINSIGHT && POWERINSIGHT_GPU_OPP_STATS
	help
	  This driver provides PowerInsight feature
```

## drivers/powerinsight/gpu_stats/Kconfig
```kconfig
config POWERINSIGHT_GPU_OPP
	tristate "xiaomi gpu opp stats"
	default n

config POWERINSIGHT_GPU_OPP_STATS
	bool "xiaomi gpu opp stats config"
	default n
```

## drivers/xiaomi/Kconfig
```kconfig
source "$(KCONFIG_EXT_PREFIX)drivers/xiaomi/memcheck/Kconfig"
source "$(KCONFIG_EXT_PREFIX)drivers/xiaomi/hypsys_netlink/Kconfig"
source "$(KCONFIG_EXT_PREFIX)drivers/xiaomi/swinfo/Kconfig"
source "$(KCONFIG_EXT_PREFIX)drivers/xiaomi/dump_display/Kconfig"
source "$(KCONFIG_EXT_PREFIX)drivers/xiaomi/boottime/Kconfig"
source "$(KCONFIG_EXT_PREFIX)drivers/xiaomi/mtdoops/Kconfig"
source "$(KCONFIG_EXT_PREFIX)drivers/xiaomi/mi_trace/Kconfig"
source "$(KCONFIG_EXT_PREFIX)drivers/xiaomi/printk_enhance/Kconfig"
source "$(KCONFIG_EXT_PREFIX)drivers/xiaomi/mi_stack/Kconfig"
source "$(KCONFIG_EXT_PREFIX)drivers/xiaomi/mi_ubt/Kconfig"
source "$(KCONFIG_EXT_PREFIX)drivers/xiaomi/bootmonitor/Kconfig"
```

## drivers/xiaomi/hypsys_netlink/Kconfig
```kconfig
config MI_HYPSYS_NETLINK
	tristate "hypsys communications"
	default n
	help
	  This feature support hypsys communications
```

## drivers/xiaomi/memcheck/Kconfig
```kconfig
config MI_MEMCHECK
	tristate "DFX memory checker module"
	default n
	help
	  This feature support memory leak check

config MI_MEMCHECK_PROCESS_MEM
	depends on (MI_MEMCHECK && ASHMEM)
	bool "ashmem memory checker module"
	default n
	help
	  This feature support memory leak check

config MI_MEMCHECK_ASHMEM
	depends on (MI_MEMCHECK && ASHMEM)
	bool "ashmem memory checker module"
	default n
	help
	  This feature support memory leak check

config MI_MEMCHECK_CMA
	depends on (MI_MEMCHECK && CMA)
	bool "cma memory checker module"
	default n
	help
	  This feature support memory leak check

config MI_MEMCHECK_FD_FENCE
	depends on (MI_MEMCHECK && KFENCE)
	bool "fd_fence memory checker module"
	default n
	help
	  This feature support memory leak check

config MI_MEMCHECK_FD_PIPE
	depends on MI_MEMCHECK
	bool "fd_pipe memory checker module"
	default n
	help
	  This feature support memory leak check

config MI_MEMCHECK_FD_SOCKET
	depends on MI_MEMCHECK
	bool "fd_socket memory checker module"
	default n
	help
	  This feature support memory leak check

config MI_MEMCHECK_DMABUF
	depends on MI_MEMCHECK
	bool "fd_socket memory checker module"
	default n
	help
	  This feature support memory leak check

config MI_MEMCHECK_GPUMEM
	depends on MI_MEMCHECK
	bool "gpumem memory checker module"
	default n
	help
	  This feature support memory leak check

config MI_MEMCHECK_SLAB
	depends on MI_MEMCHECK
	bool "slab memory checker module"
	default n
	help
	  This feature support memory leak check

config MI_MEMCHECK_VMALLOC
	depends on MI_MEMCHECK
	bool "vmalloc memory checker module"
	default n
	help
	  This feature support memory leak check


config MI_MEMCHECK_STACK
	depends on MI_MEMCHECK
	bool "DFX memory checker stack info module"
	default n
	help
	  This feature support getting stack info
```

## drivers/xiaomi/mi_kernel_monitor/Kconfig
```kconfig
config MI_KERNEL_MONITOR
       tristate "Allow xiaomi kernel monitor"
       default n
       help
         Allow xiaomi kernel latency monitor feature
```

## drivers/xiaomi/mtdoops/Kconfig
```kconfig
# SPDX-License-Identifier: GPL-2.0-only
#
# Mi mtdoops
#

config MI_MTDOOPS
	tristate "mtdoops record"
	default n
	help
	This adds support for mi mtdoops.
```

## sound/soc/codecs/Kconfig
```kconfig
# SPDX-License-Identifier: GPL-2.0-only
#
# Input misc drivers configuration
#

config SND_SOC_ALL_CODECS
	tristate "Build all ASoC CODEC drivers"
	depends on COMPILE_TEST
	imply SND_SOC_CS40L26

config SND_SOC_CS40L26
	tristate "Cirrus Logic CS40L26 Stub CODEC"
	depends on INPUT_CS40L26_I2C || INPUT_CS40L26_SPI
```

## sound/soc/codecs/fs1xxx/Kconfig
```kconfig
config SND_SOC_FS1XXX
	tristate "SoC Audio for FS1815CN"
	depends on I2C
	help
		This option enables support for FS1815CN
```

## xiaomi-modules/consumerir/Kconfig
```kconfig
config XIAOMI_IR_SPI
	tristate "support kernel spi_ir"
	default n
	help
	  Say yes here to support kernel spi_ir
```

## xiaomi-modules/keyboard_driver/jinghu/Kconfig
```kconfig
config KEYBOARD_XIAOMI_O80
	tristate "Xiaomi Keyboard"
	help
	  Say Y here if you enable xiaomi keyboard.

	  If unsure, say N.

	  To compile this driver as a module, choose M here:
```

## xiaomi-modules/mca/Kconfig
```kconfig
# SPDX-License-Identifier: GPL-2.0-only

config	XM_POWER_SUPPLY
	tristate "mca protocol pd config"
	help
	  Say Y or M here to enable mca protocol pd

config	MCA_PROTOCOL_PD
	tristate "mca protocol pd config"
	help
	  Say Y or M here to enable mca protocol pd

config	MCA_XRING_USB
	tristate "mca xring usb config"
	help
	  Say Y or M here to enable mca xring usb

config	MCA_PROTOCOL_QC
	tristate "mca protocol qc config"
	help
	  Say Y or M here to enable mca protocol qc

config	MCA_PROTOCOL_EXTERNAL_TCPC
	tristate "mca protocol external tcpc config"
	help
	  Say Y or M here to enable mca protocol external tcpc

config	MCA_EXTERNAL_CHIP
	tristate "mca external chip config"
	help
	  Say Y or M here to enable mca external chip

config	MCA_EXTERNAL_WIRELESS
	tristate "mca external wireless config"
	help
	  Say Y or M here to enable mca external wireless

config  MCA_EXTERNAL_WIRELESS_SC9625_TX
        tristate "mca external wireless sc9625 tx config"
        help
          Say Y or M here to enable mca external wireless
config  MCA_EXTERNAL_LOADSWITCH
	tristate "SC7601 load switch driver"
	help
	  Say Y to enable support for sc7601 load switch driver

config  MCA_EXTERNAL_FG
	tristate "BQ27z561 fuel gauge driver"
	help
	  Say Y to enable support for bq27z561 fuel gauge driver

config QTI_BATTERY_CHARGER
	tristate "QTI Glink battery charger"
	depends on QTI_PMIC_GLINK
	help
	  Say Y here to enable Qualcomm Technologies, Inc. battery charger
	  driver which interfaces with the charger firmware running on the
	  remote subsystem (e.g. DSP) by communicating over PMIC Glink channel
	  and provides information about the battery, USB and wireless charging
	  by exposing them as power supply devices.

	  To compile the driver as a module, choose M here: the module will be
	  called qti_battery_charger.

config  MCA_EXTERNAL_CP
	tristate "charge pump driver"
	help
	  Say Y to enable support for charge pump driver

config MCA_SC6601_SUBPMIC
	tristate "charge pump driver"
        help
          Say Y to enable support for charge pump driver

config CHARGER_PUMP_SC8541
	tristate "charge pump sc8541 driver"
        help
          Say Y to enable support for charge pump driver

config CHARGER_PUMP_NU2115
        tristate "charge pump nu2115 driver"
        help
          Say Y to enable support for charge pump driver

config CHARGER_PUMP_SC8585
        tristate "charge pump sc8585 driver"
        help
          Say Y to enable support for charge pump driver

config MCA_CHARGER_PUMP_SC8577
        tristate "charge pump sc8577 driver"
        help
          Say Y to enable support for charge pump driver

config MCA_CHARGER_PUMP_SC8510
        tristate "charge pump sc8510 driver"
        help
          Say Y to enable support for charge pump driver

config TCPC_RT1711H
       tristate "tcpc rt1711h"
        help
          Say Y to enable support for tcpc rt1711h driver

config  XM_USB_PDPHY
        tristate "Xiaomi usb pdphy config"
        help
          Say Y or M here to enable xiaomi usb pdphy

config MCA_O1_SYSFS
        tristate "mca o1  platform sysfs"
        help
          Say Y or M to enable support for mca o1 sysfs

config MCA_XM_SUBPMIC
	tristate "mca xm subpmic"
        help
          Say Y or M to enable support for mca subpmic sysfs

config USB_REDRIVER
	tristate "USB super speed (plus) redriver support"
	help
	  USB super speed (plus) redriver chip used to improve
	  USB signal which have long path(USB connector <-->
	  FPC cable <---> USB PHY).

	  Normally this kind of chip have i2c bus interface.

config USB_REDRIVER_PS5169
 	tristate "USB 3.1 Gen1/Gen2 10Gbps driver for PS5169 redriver"
	select REGMAP_I2C
	help
	   If you're using  ps5169 file
	   platform, please say 'Y' or 'M' here.

config MCA_SUBPMIC_SYSFS
        tristate "mca subpmic platform sysfs"
        help
          Say Y or M to enable support for mca subpmic sysfs

config MCA_EXTERNAL_BOOST
	tristate "mca external boost"
    help
      Say Y or M to enable support for mca external boost
config MCA_XM_SUBPMIC_SC6601A
        tristate "subpmic sc6601a"
    help
      Say Y or M to enable support for subpmic sc6601a

config MCA_XM_SUBPMIC_SC6601A_DRIVER
        tristate "subpmic sc6601a driver"
    help
      Say Y or M to enable support for subpmic sc6601a driver

config MCA_XM_SUBPMIC_SC6601A_CID
        tristate "subpmic sc6601a cid"
    help
      Say Y or M to enable support for subpmic sc6601a cid

config MCA_SUPPORT_HBM_MODE
        tristate "support hbm mode"
    help
      Say Y or M to enable support for hbm mode

config TCPC_CLASS
	tristate "TypeC Port Controller Device Class"
	select TYPEC
	help
	  Say Y to enable
	  Typec Port
	  Controller Device
	  Class

config USB_POWER_DELIVERY
	tristate "Support USB power delivery Function"
	depends on TCPC_CLASS
	default n
	help
	  Say Y to enable
	  USB
	  Power Delivery
	  support
config TCPC_SC660X
	tristate "SouthChip SC660X TypeC port Controller Driver"
	depends on TCPC_CLASS
	default n
	help
	  Say Y to enable
	  SouthChip SC660X
	  TypeC port Controller
	  Driver

config TCPC_SC2150
	tristate "SouthChip SC2150 TypeC port Controller Driver"
	depends on TCPC_CLASS
	default n
	help
	  Say Y to enable
	  SouthChip SC2150
	  TypeC port Controller
	  Driver
```

## xiaomi-modules/mi_dynamic_readahead/Kconfig
```kconfig
config MI_DYNAMIC_READAHEAD
	tristate "dynamic pagecache readahead"
	default n
	help
	  This driver used for dynamically tuning filemap readahead for performance.
```
